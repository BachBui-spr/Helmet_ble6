## CMakeLists.txt
```
cmake_minimum_required(VERSION 3.20.0)

# Lop 1-2 dung chung (lib/) la mot Zephyr module: chi build module bat trong prj.conf
set(ME54_LIB ${CMAKE_CURRENT_SOURCE_DIR}/../../lib)
list(APPEND ZEPHYR_EXTRA_MODULES ${ME54_LIB})

find_package(Zephyr REQUIRED HINTS $ENV{ZEPHYR_BASE})
project(bike_hub)

# Lop 3-4 cua hub: include theo duong dan tu src/ ("app/app.h", "features/phone/phone_sink.h")
target_include_directories(app PRIVATE
  src
  ${ME54_LIB}/services/include
  ${ME54_LIB}/hal/include
  ${ME54_LIB}/core/include
  ${ME54_LIB}/proto/include)

add_subdirectory(src/app)                 # lop 4: ung dung
add_subdirectory(src/features/phone)      # lop 3: chuc nang
add_subdirectory(src/features/broadcast)
add_subdirectory(src/features/nav)
```

## prj.conf
```kconfig
# ============================================================
#  Bike hub (apps/bike) - trung tam am thanh tren xe
#  Dien thoai --(LE Audio unicast, CIS)--> hub --(Auracast broadcast, BIG)--> nhieu mu
#  Thiet ke: docs/BIKE_HUB_THIET_KE.md
#  Hub KHONG giai ma / ma hoa lai: chuyen nguyen khung LC3 tu CIS sang BIS.
# ============================================================

# ---- Log + shell qua SEGGER RTT (scripts/rtt.sh build/bike) ----
CONFIG_LOG=y
CONFIG_LOG_MODE_DEFERRED=y
CONFIG_LOG_BUFFER_SIZE=4096
CONFIG_USE_SEGGER_RTT=y
CONFIG_SEGGER_RTT_BUFFER_SIZE_UP=4096
CONFIG_SEGGER_RTT_BUFFER_SIZE_DOWN=256
CONFIG_SHELL=y
CONFIG_SHELL_BACKEND_SERIAL=n
CONFIG_SHELL_BACKEND_RTT=y
CONFIG_SHELL_STACK_SIZE=3072
CONFIG_KERNEL_SHELL=y
CONFIG_THREAD_NAME=y
CONFIG_THREAD_MONITOR=y
CONFIG_THREAD_STACK_INFO=y
CONFIG_THREAD_RUNTIME_STATS=y
CONFIG_MAIN_STACK_SIZE=3072
CONFIG_SYSTEM_WORKQUEUE_STACK_SIZE=2560

# ---- Bluetooth LE co ban ----
CONFIG_BT=y
CONFIG_BT_PERIPHERAL=y
CONFIG_BT_DEVICE_NAME="Bike_Hub"
CONFIG_BT_HCI_ERR_TO_STR=y
# Dien thoai + toi da 2 mu dang ghep cung luc (mu doc Join Info roi ngat ngay) + du phong: moi bo
# quang ba co the ket noi dang chay giu san 1 o bt_conn, nen 3 o la het khi dien thoai + 2 mu.
# Che do Dinh vi: dien thoai + 2 mu do khoang cach (mu la central) + 2 bo quang ba co the ket noi.
CONFIG_BT_MAX_CONN=5
CONFIG_BT_CTLR_SDC_PERIPHERAL_COUNT=5
CONFIG_BT_GAP_AUTO_UPDATE_CONN_PARAMS=n
# PPCP (dien thoai co doc: do 23/10/2026 no chon 75 ms trong dai cu 62,5-87,5 ms) = 33,75 ms / 6 s,
# trung voi gia tri main.c xin: khong phai boi so 10 ms nen ACL khong khoa pha voi BIG.
CONFIG_BT_PERIPHERAL_PREF_MIN_INT=27
CONFIG_BT_PERIPHERAL_PREF_MAX_INT=27
CONFIG_BT_PERIPHERAL_PREF_LATENCY=0
CONFIG_BT_PERIPHERAL_PREF_TIMEOUT=600

# Bon bo quang ba: (1) cho dien thoai; (2) Auracast + PA, cho mu; (3) cua so ghep mu;
# (4) Dinh vi (legacy, co the ket noi)
CONFIG_BT_EXT_ADV=y
CONFIG_BT_EXT_ADV_MAX_ADV_SET=4
CONFIG_BT_PER_ADV=y
CONFIG_BT_CTLR_ADV_DATA_LEN_MAX=191

# ---- Bao mat + luu bond / cai dat (phan vung storage, ZMS) ----
CONFIG_BT_SMP=y
CONFIG_BT_SMP_ALLOW_UNAUTH_OVERWRITE=y
CONFIG_BT_PRIVACY=y
CONFIG_BT_MAX_PAIRED=8
CONFIG_BT_KEYS_OVERWRITE_OLDEST=y
CONFIG_BT_SETTINGS=y
CONFIG_SETTINGS=y
CONFIG_FLASH=y
CONFIG_FLASH_MAP=y
CONFIG_ZMS=y
# Ghi RRAM dong bo voi radio qua MPSL timeslot. Mac dinh bo dem ghi 32 dong (512 B) -> moi lan ghi
# xin 8,1 ms radio TRONG LIEN TUC; BIG 10 ms (chiem ~5 ms) khong bao gio de trong 8,1 ms -> luu bond
# moi (trong thread BT RX) cho toi 24 s, hub ngung tra loi mu (do 20/10/2026). 1 dong (16 B):
# moi lan ghi chi can 0,6 ms, vua khoang trong cua BIG; luu bond ~vai chuc ms.
CONFIG_NRF_RRAM_WRITE_BUFFER_SIZE=1

# ---- GATT ----
CONFIG_BT_GATT_DYNAMIC_DB=y
CONFIG_BT_ATT_PREPARE_COUNT=4
CONFIG_UTF8=y

# ---- Phia dien thoai: BAP Unicast Server, chi chieu NHAN (hub khong co micro) ----
CONFIG_BT_AUDIO=y
CONFIG_BT_ISO_PERIPHERAL=y
CONFIG_BT_BAP_UNICAST_SERVER=y
CONFIG_BT_ASCS=y
CONFIG_BT_ASCS_MAX_ASE_SNK_COUNT=2
CONFIG_BT_ASCS_MAX_ASE_SRC_COUNT=0
CONFIG_BT_PAC_SNK=y
CONFIG_BT_PAC_SNK_LOC=y
CONFIG_BT_CAP_ACCEPTOR=y
# Metadata dien thoai gui kem Enable (contexts + CCID...)
CONFIG_BT_AUDIO_CODEC_CFG_MAX_METADATA_SIZE=32
# Khong co VCS: dien thoai tu giam am luong trong du lieu (software volume) truoc khi ma hoa,
# nen thanh am luong tren dien thoai van dieu khien duoc tieng o moi mu.

# ---- Phia mu: BAP Broadcast Source, 1 subgroup: 1 BIS stereo (BIG 20 ms) hoac 2 BIS trai / phai ----
CONFIG_BT_ISO_BROADCASTER=y
# BIG 20 ms, BN 2 tao bang LE Create BIG Test (bcast_source.c); tham so = 0 -> Create BIG thuong
CONFIG_BT_ISO_TEST_PARAMS=y
CONFIG_BT_BAP_BROADCAST_SOURCE=y
CONFIG_BT_BAP_BROADCAST_SRC_STREAM_COUNT=2
CONFIG_BT_BAP_BROADCAST_SRC_SUBGROUP_COUNT=1
CONFIG_BT_ISO_MAX_BIG=1
CONFIG_BT_CTLR_ADV_ISO_STREAM_MAX=2
CONFIG_BT_CTLR_ADV_ISO_STREAM_COUNT=2
# Thoi gian controller CHUA LAI cho vai tro khac trong moi chu ky ISO 10 ms khi chon tham so BIG.
# Mac dinh 1600 us: BIG chiem gan het, ket noi ACL (mu dang ghep, dien thoai) bi bo lot -> ghep
# doi treo 19 s roi mat lien ket 0x08 (do 20/10/2026; tat BIG thi ghep xong trong 1 s).
# 5000 us: BIG gon trong ~5 ms, con ~5 ms cho ACL + CIS nhac tu dien thoai + quang ba.
CONFIG_BT_CTLR_SDC_BIG_RESERVED_TIME_US=5000

# ---- Kenh ISO: toi da 2 CIS tu dien thoai + 2 BIS phat ----
CONFIG_BT_ISO_MAX_CHAN=4
CONFIG_BT_ISO_RX_BUF_COUNT=4
# SDU phat lon nhat: BIS stereo 2 x 120 B = 240 B (toi da 250 B = 1 PDU)
CONFIG_BT_ISO_TX_MTU=251
CONFIG_BT_ISO_TX_BUF_COUNT=6
CONFIG_BT_CTLR_SDC_ISO_TX_HCI_BUFFER_COUNT=6

# ---- LC3: chi de tao san mot khung "im lang" luc khoi dong (khong ma hoa lien tuc) ----
CONFIG_FPU=y
CONFIG_LIBLC3=y

# ---- Nut (gpio-keys -> input), am bao qua loa (I2S20 -> MAX98357A), bat / tat (System OFF) ----
CONFIG_INPUT=y
CONFIG_I2S=y
CONFIG_POWEROFF=y
CONFIG_HWINFO=y

# ---- Thu vien dung chung lib/ (lop 1-2; dung chung voi mu) ----
# Am bao doc lap qua I2S (khoi 10 ms 16 kHz stereo = 640 B), nut, nguon, khung LC3 im lang
CONFIG_ME54_SVC_PROMPT_PLAYER=y
CONFIG_ME54_HAL_I2S_OUT_BLOCK_BYTES=640
CONFIG_ME54_HAL_KEYS=y
CONFIG_ME54_HAL_POWER=y
CONFIG_ME54_CORE_LC3_SILENCE=y

# ---- Che do Dinh vi (features/nav/nav_hub.c, docs/HELMET_NAV_DINH_VI.md) ----
# Hub chi PHAN XA (CS reflector) toi da 2 mu; mu tao cau hinh, bat bao mat, do va tu tinh (IPT).
CONFIG_BT_CHANNEL_SOUNDING=y
CONFIG_BT_CTLR_SDC_CS_ROLE_REFLECTOR_ONLY=y
CONFIG_BT_CTLR_SDC_CS_COUNT=2
CONFIG_BT_CTLR_SDC_CS_MAX_ANTENNA_PATHS=1
CONFIG_BT_CTLR_SDC_CS_NUM_ANTENNAS=1
CONFIG_BT_CTLR_SDC_CS_STEP_MODE3=n
CONFIG_BT_CTLR_CHANNEL_SOUNDING_TEST=n
# Bat buoc cho CS enhancements (IPT)
CONFIG_BT_CTLR_EXTENDED_FEAT_SET=y
# Cho phep CS va ACL dung PHY khac nhau
CONFIG_BT_TRANSMIT_POWER_CONTROL=y
# Ket qua subevent (ca o ben phan xa) rap lai trong host: 1 bo dem cho moi thu tuc song song
CONFIG_BT_CHANNEL_SOUNDING_REASSEMBLY_BUFFER_CNT=2
CONFIG_BT_CHANNEL_SOUNDING_REASSEMBLY_BUFFER_SIZE=1000
```

## src/main.c
```c
/*
 * Bike hub (apps/bike) - trung tam am thanh tren xe.
 * Thiet ke: docs/BIKE_HUB_THIET_KE.md
 *
 *   Dien thoai --(LE Audio unicast: CIS, LC3 48 kHz)--> hub --(Auracast: BIG)--> moi mu
 *
 * Dien thoai ghep doi voi hub nhu mot thiet bi LE Audio thuong ("Bike_Hub", chi chieu nhan).
 * Mu (apps/main) ghep voi hub BANG NUT, khong go ma (bhs.c):
 *   hub: Power ngan -> giu Vol+ 2 s (mo cua so 60 s); mu: Power ngan -> giu Call 2 s.
 * Mu nhan broadcast ID + dia chi + ma ngau nhien, vao broadcast "Bike Audio", va tu vao lai
 * moi lan bat. So mu khong gioi han. Hub chi chuyen tiep khung LC3, khong giai ma.
 *
 * Thu tu khoi dong (giong apps/main): dang ky PACS + ASCS TRUOC bt_enable() de Database Hash
 * khong doi giua cac lan khoi dong (tranh vong lap ket noi / ngat cua dien thoai).
 */

#include <errno.h>
#include <stdlib.h>
#include <string.h>

#include <zephyr/kernel.h>
#include <zephyr/bluetooth/audio/audio.h>
#include <zephyr/bluetooth/audio/bap.h>
#include <zephyr/bluetooth/bluetooth.h>
#include <zephyr/bluetooth/conn.h>
#include <zephyr/bluetooth/gap.h>
#include <zephyr/bluetooth/hci.h>
#include <zephyr/bluetooth/uuid.h>
#include <zephyr/logging/log.h>
#include <zephyr/settings/settings.h>
#include <zephyr/shell/shell.h>
#include <zephyr/sys/byteorder.h>

#include "bike.h"

LOG_MODULE_REGISTER(bike, LOG_LEVEL_INF);

#define HEARTBEAT_S   10
#define SEC_TIMEOUT_S 30

/* Chu ky ACL xin dien thoai dung (do 23/10/2026). Dien thoai tu chon chu ky la boi so cua 10 ms ->
 * moi su kien ACL roi cung mot pha voi BIG 10 ms cua hub. SDC uu tien BIG (muc 2) hon ACL cua
 * peripheral (muc 3) -> o pha xau ACL bi bo lien tuc: ma hoa cham 3-9 s, mat ket noi 0x08.
 * 33,75 ms lech 3,75 ms moi su kien so voi chu ky BIG nen chi mot phan nho su kien trung BIG (nhu
 * hub_link 11,25 ms cua mu). Supervision 6 s de chiu duoc cac su kien bi bo.
 */
#define PHONE_CONN_INT    27  /* x 1,25 ms = 33,75 ms */
#define PHONE_SUP_TIMEOUT 600 /* x 10 ms = 6 s */
#define PHONE_PARAM_TRIES 5   /* moi ket noi: dien thoai doi lai thi xin lai toi da 5 lan */

#define SINK_CONTEXTS_ADV                                                                          \
	(BT_AUDIO_CONTEXT_TYPE_UNSPECIFIED | BT_AUDIO_CONTEXT_TYPE_MEDIA |                         \
	 BT_AUDIO_CONTEXT_TYPE_GAME | BT_AUDIO_CONTEXT_TYPE_INSTRUCTIONAL)

static struct bt_le_ext_adv *adv_phone;
static struct bt_conn *phone_conn;
static bt_security_t sec_level;

static uint8_t param_tries;

static void adv_work_fn(struct k_work *w);
static K_WORK_DEFINE(adv_work, adv_work_fn);
static void sec_timeout_fn(struct k_work *w);
static K_WORK_DELAYABLE_DEFINE(sec_timeout_work, sec_timeout_fn);
static void phone_param_fn(struct k_work *w);
static K_WORK_DELAYABLE_DEFINE(phone_param_work, phone_param_fn);

/* ---------------- Quang ba cho dien thoai (co the ket noi) ---------------- */

/* ASCS: thong bao chung, nhan cac ngu canh tren, khong co chieu gui */
static const uint8_t ascs_addata[] = {
	BT_UUID_16_ENCODE(BT_UUID_ASCS_VAL),
	BT_AUDIO_UNICAST_ANNOUNCEMENT_GENERAL,
	BT_BYTES_LIST_LE16(SINK_CONTEXTS_ADV),
	BT_BYTES_LIST_LE16(0),
	0x00, /* metadata length */
};

static const uint8_t cas_addata[] = {
	BT_UUID_16_ENCODE(BT_UUID_CAS_VAL),
	BT_AUDIO_UNICAST_ANNOUNCEMENT_GENERAL,
};

static const struct bt_data ad_phone[] = {
	BT_DATA_BYTES(BT_DATA_FLAGS, (BT_LE_AD_GENERAL | BT_LE_AD_NO_BREDR)),
	BT_DATA_BYTES(BT_DATA_GAP_APPEARANCE, BT_BYTES_LIST_LE16(BT_APPEARANCE_GENERIC_AUDIO_SINK)),
	BT_DATA_BYTES(BT_DATA_UUID16_SOME, BT_UUID_16_ENCODE(BT_UUID_ASCS_VAL),
		      BT_UUID_16_ENCODE(BT_UUID_CAS_VAL), BT_UUID_16_ENCODE(BT_UUID_PACS_VAL)),
	BT_DATA(BT_DATA_SVC_DATA16, cas_addata, ARRAY_SIZE(cas_addata)),
	BT_DATA(BT_DATA_SVC_DATA16, ascs_addata, ARRAY_SIZE(ascs_addata)),
	BT_DATA(BT_DATA_NAME_COMPLETE, CONFIG_BT_DEVICE_NAME, sizeof(CONFIG_BT_DEVICE_NAME) - 1),
};

/* Quang ba khi chua co dien thoai. Controller tu dung khi co ket noi den. */
static void adv_work_fn(struct k_work *w)
{
	int err;

	ARG_UNUSED(w);
	if (adv_phone == NULL || phone_conn != NULL) {
		return;
	}
	err = bt_le_ext_adv_start(adv_phone, BT_LE_EXT_ADV_START_DEFAULT);
	if (err == 0) {
		LOG_INF("Advertising to phones as \"%s\"", CONFIG_BT_DEVICE_NAME);
	} else if (err != -EALREADY) {
		LOG_WRN("Phone advertising start failed (%d)", err);
	}
}

static int adv_phone_create(void)
{
	int err = bt_le_ext_adv_create(BT_BAP_ADV_PARAM_CONN_QUICK, NULL, &adv_phone);

	if (err) {
		LOG_ERR("Phone advertising set create failed (%d)", err);
		return err;
	}
	err = bt_le_ext_adv_set_data(adv_phone, ad_phone, ARRAY_SIZE(ad_phone), NULL, 0);
	if (err) {
		LOG_ERR("Phone advertising data failed (%d)", err);
	}
	return err;
}

/* ---------------- Ket noi / bao mat ---------------- */

/* Ket noi den co the la dien thoai hoac mu dang ghep (qua bo quang ba cua so ghep). Mu duoc
 * nhan ra khi doc Join Info (hub_on_helmet); truoc do tam coi la dien thoai.
 */
static void connected(struct bt_conn *conn, uint8_t err)
{
	char addr[BT_ADDR_LE_STR_LEN];

	bt_addr_le_to_str(bt_conn_get_dst(conn), addr, sizeof(addr));
	if (err) {
		LOG_WRN("Connection from %s failed (0x%02x %s)", addr, err, bt_hci_err_to_str(err));
		k_work_submit(&adv_work);
		return;
	}
	if (phone_conn == NULL) {
		phone_conn = bt_conn_ref(conn);
		sec_level = BT_SECURITY_L1;
	}
	LOG_INF("Connected: %s", addr);

	/* LE Audio yeu cau ma hoa */
	if (bt_conn_set_security(conn, BT_SECURITY_L2) != 0) {
		LOG_WRN("Security request failed");
	}
	k_work_reschedule(&sec_timeout_work, K_SECONDS(SEC_TIMEOUT_S));
}

static void disconnected(struct bt_conn *conn, uint8_t reason)
{
	char addr[BT_ADDR_LE_STR_LEN];

	bt_addr_le_to_str(bt_conn_get_dst(conn), addr, sizeof(addr));
	if (bhs_is_helmet(conn)) {
		LOG_INF("Helmet %s disconnected (reason 0x%02x)", addr, reason);
		bhs_conn_disconnected(conn);
		return;
	}
	LOG_INF("Disconnected: %s (reason 0x%02x %s)", addr, reason, bt_hci_err_to_str(reason));
	if (conn == phone_conn) {
		(void)k_work_cancel_delayable(&sec_timeout_work);
		(void)k_work_cancel_delayable(&phone_param_work);
		bt_conn_unref(phone_conn);
		phone_conn = NULL;
		if (!bhs_pair_active()) {
			hub_tone(HUB_TONE_DISCONNECTED); /* trong cua so: thuong la mu thu ghep lai */
		}
	}
}

/* BHS: ket noi nay la mu (vua doc Join Info) chu khong phai dien thoai */
void hub_on_helmet(struct bt_conn *conn)
{
	if (conn == phone_conn) {
		(void)k_work_cancel_delayable(&sec_timeout_work);
		(void)k_work_cancel_delayable(&phone_param_work);
		bt_conn_unref(phone_conn);
		phone_conn = NULL;
		k_work_submit(&adv_work); /* tiep tuc cho dien thoai */
	}
}

static void recycled(void)
{
	k_work_submit(&adv_work); /* o bt_conn vua trong: quang ba lai cho dien thoai */
}

static void security_changed(struct bt_conn *conn, bt_security_t level, enum bt_security_err err)
{
	if (err) {
		if (bhs_pair_active()) {
			/* Cua so ghep mo: co the la mu mang khoa cu -> khong ngat de mu thay dung loi
			 * ("key missing") va tu xoa khoa + ghep lai. Dien thoai khong ma hoa duoc van bi
			 * ngat sau SEC_TIMEOUT_S; ke la khong doc duoc Join Info (can ma hoa).
			 */
			LOG_WRN("Security failed (level %d, err %d %s) - pairing window open, "
				"letting peer re-pair",
				level, err, bt_security_err_to_str(err));
			return;
		}
		LOG_WRN("Security failed (level %d, err %d %s) - disconnecting", level, err,
			bt_security_err_to_str(err));
		(void)k_work_cancel_delayable(&sec_timeout_work);
		(void)bt_conn_disconnect(conn, BT_HCI_ERR_AUTH_FAIL);
		return;
	}
	if (conn != phone_conn) {
		return; /* mu dang ghep: BHS xu ly */
	}
	(void)k_work_cancel_delayable(&sec_timeout_work);
	sec_level = level;
	LOG_INF("Link encrypted (level %d)", level);
	if (!bhs_pair_active()) {
		hub_tone(HUB_TONE_CONNECTED); /* trong cua so ghep co the la mu: khong bao */
	}
	/* 1 s sau (mu dang ghep da doc xong Join Info va duoc bo ra): xin chu ky ACL lech BIG */
	param_tries = 0;
	k_work_reschedule(&phone_param_work, K_SECONDS(1));
}

/* System workqueue: xin dien thoai doi chu ky ACL sang 33,75 ms / supervision 6 s */
static void phone_param_fn(struct k_work *w)
{
	struct bt_conn_info info;
	int err;

	ARG_UNUSED(w);
	if (phone_conn == NULL || bt_conn_get_info(phone_conn, &info) != 0) {
		return;
	}
	if (info.le.interval_us == PHONE_CONN_INT * 1250U && info.le.timeout == PHONE_SUP_TIMEOUT) {
		return;
	}
	if (param_tries >= PHONE_PARAM_TRIES) {
		return; /* dien thoai khong chiu: thoi, khong tranh nhau */
	}
	param_tries++;
	err = bt_conn_le_param_update(phone_conn, BT_LE_CONN_PARAM(PHONE_CONN_INT, PHONE_CONN_INT,
								    0, PHONE_SUP_TIMEOUT));
	LOG_INF("Phone ACL %u.%02u ms / supervision %u ms -> asking for 33.75 ms / 6 s (try %u, %d)",
		info.le.interval_us / 1000U, (info.le.interval_us % 1000U) / 10U,
		info.le.timeout * 10U, param_tries, err);
}

static void le_param_updated(struct bt_conn *conn, uint16_t interval, uint16_t latency,
			     uint16_t timeout)
{
	if (conn != phone_conn) {
		return;
	}
	LOG_INF("Phone ACL params: interval %u us, latency %u, supervision %u ms", interval * 1250U,
		latency, timeout * 10U);
	if (interval != PHONE_CONN_INT || timeout != PHONE_SUP_TIMEOUT) {
		/* Boi so cua 10 ms (30 / 60 ms...): ACL khoa pha voi BIG -> o pha xau mat MOI su kien
		 * (do 23/10/2026: 4/4 lan dien thoai tu doi sang 30 ms, lien ket chet ngay va het han
		 * 0x08 dung 5 s sau; yeu cau 3 s sau thi da muon) -> xin ngay. Chu ky khac (vd 7,5 ms
		 * luc tim dich vu): doi mot luc roi xin.
		 */
		const bool locked = (interval * 1250U) % 10000U == 0U;

		k_work_reschedule(&phone_param_work, locked ? K_NO_WAIT : K_SECONDS(3));
	}
}

/* Ket noi khong ma hoa sau 30 s (vd may khong ghep doi): ngat de dien thoai that ket noi duoc */
static void sec_timeout_fn(struct k_work *w)
{
	ARG_UNUSED(w);
	if (phone_conn != NULL && sec_level < BT_SECURITY_L2 && !bhs_is_helmet(phone_conn)) {
		LOG_WRN("Not encrypted after %d s - disconnecting", SEC_TIMEOUT_S);
		(void)bt_conn_disconnect(phone_conn, BT_HCI_ERR_AUTH_FAIL);
	}
}

BT_CONN_CB_DEFINE(conn_cbs) = {
	.connected = connected,
	.disconnected = disconnected,
	.recycled = recycled,
	.security_changed = security_changed,
	.le_param_updated = le_param_updated,
};

static void pairing_complete(struct bt_conn *conn, bool bonded)
{
	ARG_UNUSED(conn);
	LOG_INF("Pairing complete (%s)", bonded ? "bonded" : "not bonded");
}

static void pairing_failed(struct bt_conn *conn, enum bt_security_err reason)
{
	ARG_UNUSED(conn);
	LOG_WRN("Pairing failed: %d %s - forget \"%s\" on the phone and pair again", reason,
		bt_security_err_to_str(reason), CONFIG_BT_DEVICE_NAME);
}

static struct bt_conn_auth_info_cb auth_info_cb = {
	.pairing_complete = pairing_complete,
	.pairing_failed = pairing_failed,
};

/* ---------------- Shell ---------------- */

static int cmd_status(const struct shell *sh, size_t argc, char **argv)
{
	char addr[BT_ADDR_LE_STR_LEN] = "-";

	ARG_UNUSED(argc);
	ARG_UNUSED(argv);
	if (phone_conn != NULL) {
		bt_addr_le_to_str(bt_conn_get_dst(phone_conn), addr, sizeof(addr));
	}
	shell_print(sh, "Phone     : %s%s (security %d)", addr,
		    phone_conn ? "" : " (advertising)", phone_conn ? sec_level : 0);
	phone_sink_print(sh);
	bcast_source_print(sh);
	bhs_print(sh);
	return 0;
}

static int cmd_pair(const struct shell *sh, size_t argc, char **argv)
{
	ARG_UNUSED(argc);
	ARG_UNUSED(argv);
	bhs_pair_start();
	shell_print(sh, "Helmet pairing window open 60 s (same as Power short -> hold Vol+ 2 s)");
	return 0;
}

static int cmd_code(const struct shell *sh, size_t argc, char **argv)
{
	enum bike_code_mode mode = BIKE_CODE_TEXT;
	int err;

	ARG_UNUSED(argc);
	if (strcmp(argv[1], "new") == 0) {
		mode = BIKE_CODE_RANDOM;
	} else if (strcmp(argv[1], "open") == 0) {
		mode = BIKE_CODE_OPEN;
	}
	err = bcast_source_set_code(mode, mode == BIKE_CODE_TEXT ? argv[1] : NULL);
	if (err == -EINVAL) {
		shell_error(sh, "usage: bike code new | open | <text up to 16 chars>");
		return err;
	}
	shell_print(sh, "Broadcast %s - rebuilding. Paired helmets must pair again (Call button)",
		    mode == BIKE_CODE_OPEN ? "is now open (no code)" : "code changed");
	return 0;
}

static int cmd_rtn(const struct shell *sh, size_t argc, char **argv)
{
	const long r = strtol(argv[1], NULL, 10);

	ARG_UNUSED(argc);
	if (r < 0 || r > 4 || bcast_source_set_rtn((uint8_t)r) == -EINVAL) {
		shell_error(sh, "usage: bike rtn <0..4>");
		return -EINVAL;
	}
	shell_print(sh, "BIS retransmissions = %ld - rebuilding broadcast", r);
	return 0;
}

static int cmd_isoint(const struct shell *sh, size_t argc, char **argv)
{
	const long ms = strtol(argv[1], NULL, 10);

	ARG_UNUSED(argc);
	if ((ms != 10 && ms != 20) || bcast_source_set_isoint((uint8_t)ms) == -EINVAL) {
		shell_error(sh, "usage: bike isoint <10|20>");
		return -EINVAL;
	}
	shell_print(sh, "BIG interval = %ld ms (%s) - rebuilding broadcast", ms,
		    ms == 20 ? "1 stereo BIS, BN 2" : "2 BIS left / right");
	return 0;
}

static int cmd_unpair(const struct shell *sh, size_t argc, char **argv)
{
	int err;

	ARG_UNUSED(argc);
	ARG_UNUSED(argv);
	if (phone_conn != NULL) {
		(void)bt_conn_disconnect(phone_conn, BT_HCI_ERR_REMOTE_USER_TERM_CONN);
	}
	err = bt_unpair(BT_ID_DEFAULT, BT_ADDR_LE_ANY);
	shell_print(sh, "%s", err ? "Unpair failed" : "All phone bonds deleted");
	return err;
}

SHELL_STATIC_SUBCMD_SET_CREATE(bike_cmds,
	SHELL_CMD(status, NULL, "Phone link, ASEs, broadcast and relay statistics", cmd_status),
	SHELL_CMD(pair, NULL, "Open helmet pairing window 60 s", cmd_pair),
	SHELL_CMD_ARG(code, NULL, "Broadcast code: bike code new | open | <text>", cmd_code, 2, 0),
	SHELL_CMD_ARG(rtn, NULL, "BIS retransmissions: bike rtn <0..4> (default 0; the 20 ms BIG "
		      "uses at most 1; more blocks the phone's audio)", cmd_rtn, 2, 0),
	SHELL_CMD_ARG(isoint, NULL, "BIG interval: bike isoint 20 (default: 1 stereo BIS, BN 2) | "
		      "10 (2 BIS left / right)", cmd_isoint, 2, 0),
	SHELL_CMD(unpair, NULL, "Delete all phone bonds", cmd_unpair),
	SHELL_SUBCMD_SET_END);

SHELL_CMD_REGISTER(bike, &bike_cmds, "Bike audio hub", NULL);

/* ---------------- Nut ---------------- */

static void unpair_all(void)
{
	bhs_pair_cancel();
	if (phone_conn != NULL) {
		(void)bt_conn_disconnect(phone_conn, BT_HCI_ERR_REMOTE_USER_TERM_CONN);
	}
	if (bt_unpair(BT_ID_DEFAULT, BT_ADDR_LE_ANY) == 0) {
		LOG_INF("All bonds deleted (phone + helmets)");
		hub_tone(HUB_TONE_UNPAIR);
	}
}

/* Thread hub_ui */
void hub_gesture(enum hub_gesture g)
{
	switch (g) {
	case HUB_G_STATUS:
		if (bhs_pair_active()) {
			bhs_pair_cancel(); /* Power ngan khi dang ghep: dong cua so */
		} else {
			hub_tone(phone_conn ? HUB_TONE_STATUS_OK : HUB_TONE_STATUS_NO_LINK);
		}
		break;
	case HUB_G_POWER_OFF:
		hub_power_off();
		break;
	case HUB_G_PAIR:
		bhs_pair_start();
		break;
	case HUB_G_UNPAIR:
		unpair_all();
		break;
	case HUB_G_CALL:
		LOG_INF("Call button: not used yet");
		break;
	default:
		break;
	}
}

static void disconnect_cb(struct bt_conn *conn, void *data)
{
	ARG_UNUSED(data);
	(void)bt_conn_disconnect(conn, BT_HCI_ERR_REMOTE_POWER_OFF);
}

void hub_bt_shutdown(void)
{
	bhs_pair_cancel();
	if (adv_phone != NULL) {
		(void)bt_le_ext_adv_stop(adv_phone);
	}
	bt_conn_foreach(BT_CONN_TYPE_LE, disconnect_cb, NULL);
	k_msleep(300);
}

/* ---------------- main ---------------- */

int main(void)
{
	int err;

	(void)hub_power_boot_check(); /* thuc tu System OFF: phai giu Power 2 s */
	LOG_INF("=== Bike hub (apps/bike): phone LE Audio -> Auracast broadcast to helmets ===");
	(void)hub_ui_init();

	/* GATT dong (PACS, ASCS) truoc bt_enable(): xem chu thich dau file */
	err = phone_sink_register();
	if (err) {
		return err;
	}

	err = bt_enable(NULL);
	if (err) {
		LOG_ERR("Bluetooth init failed (%d)", err);
		return err;
	}
	if (IS_ENABLED(CONFIG_BT_SETTINGS)) {
		settings_load(); /* bond, identity, bike/bid, bike/code, bike/rtn, bike/isoint */
	}
	bt_conn_auth_info_cb_register(&auth_info_cb);

	err = phone_sink_init();
	if (err) {
		return err;
	}
	err = bcast_source_init();
	if (err) {
		LOG_ERR("Broadcast init failed (%d)", err);
		return err;
	}
	err = bhs_init();
	if (err) {
		return err;
	}
	err = adv_phone_create();
	if (err) {
		return err;
	}
	k_work_submit(&adv_work);
	hub_tone(HUB_TONE_POWER_ON);

	while (1) {
		k_sleep(K_SECONDS(HEARTBEAT_S));
		LOG_INF("heartbeat: phone %s, %s", phone_conn ? "connected" : "advertising",
			phone_sink_streaming() ? "STREAMING" : "idle");
		bcast_source_log_status();
		phone_sink_log_status();
	}
	return 0;
}
```

## src/bhs.c
```c
/*
 * Bike hub - Bike Hub Service (BHS) va cua so ghep mu.
 *
 * Ghep bang nut (khong go ma):
 *   Hub:  Power ngan -> giu Vol+ 2 s  -> mo cua so 60 s: bo quang ba rieng, co the ket noi, mang
 *         Service Data 128 bit {BHS UUID, ver, co "dang ghep"} (am "dang tim" lap).
 *   Mu:   Power ngan -> giu Call 2 s  -> mu quet, thay co "dang ghep" -> ket noi (central) -> ma
 *         hoa (Just Works, luu bond) -> doc Join Info -> ngat -> vao broadcast ngay, luu lai de
 *         nhung lan bat sau tu vao (apps/main/src/hub_link.c + broadcast_sink.c).
 *   Join Info chi doc duoc khi lien ket da ma hoa VA cua so ghep dang mo, nen ma broadcast chi
 *   den tay mu ma nguoi dung chu dong ghep.
 *
 * Nhan dien mu: ket noi nao doc Join Info la mu (hub_on_helmet); dien thoai khong doc dac tinh
 * nay. Mu tu ngat sau khi doc; hub ngat ho sau 3 s neu mu chua ngat.
 */

#include <errno.h>
#include <string.h>

#include <zephyr/kernel.h>
#include <zephyr/bluetooth/bluetooth.h>
#include <zephyr/bluetooth/conn.h>
#include <zephyr/bluetooth/gatt.h>
#include <zephyr/bluetooth/hci.h>
#include <zephyr/bluetooth/uuid.h>
#include <zephyr/logging/log.h>
#include <zephyr/shell/shell.h>
#include <zephyr/sys/atomic.h>

#include "bike.h"

LOG_MODULE_REGISTER(bhs, LOG_LEVEL_INF);

#define PAIR_WINDOW_S  60
#define HELMET_LINK_MS 3000 /* sau khi doc Join Info: mu chua tu ngat thi hub ngat */
#define MAX_HELMET_LINKS (CONFIG_BT_MAX_CONN)

static const struct bt_uuid_128 bhs_uuid = BT_UUID_INIT_128(BHS_UUID_SVC_VAL);
static const struct bt_uuid_128 join_uuid = BT_UUID_INIT_128(BHS_UUID_JOIN_VAL);

static atomic_t window_open;
static atomic_t joined_window; /* so mu doc Join Info trong cua so hien tai */
static uint32_t joined_total;

/* Ket noi da doc Join Info (bt_rx ghi, work doc) */
static struct k_spinlock lock;
static struct bt_conn *helmets[MAX_HELMET_LINKS];
static struct bt_conn *pending_helmet; /* vua doc, cho work xu ly */

static struct bt_le_ext_adv *adv_pair;

static void close_work_fn(struct k_work *w);
static void helmet_work_fn(struct k_work *w);
static void adv_work_fn(struct k_work *w);
static void kick_work_fn(struct k_work *w);
static K_WORK_DELAYABLE_DEFINE(close_work, close_work_fn);
static K_WORK_DEFINE(helmet_work, helmet_work_fn);
static K_WORK_DEFINE(pair_adv_work, adv_work_fn);
static K_WORK_DELAYABLE_DEFINE(kick_work, kick_work_fn);

/* ---------------- GATT ---------------- */

static bool is_helmet_locked(const struct bt_conn *conn)
{
	for (size_t i = 0; i < ARRAY_SIZE(helmets); i++) {
		if (helmets[i] == conn) {
			return true;
		}
	}
	return false;
}

static ssize_t join_read(struct bt_conn *conn, const struct bt_gatt_attr *attr, void *buf,
			 uint16_t len, uint16_t offset)
{
	uint8_t v[BHS_JOIN_INFO_LEN];
	k_spinlock_key_t key;
	bool fresh = false;

	if (!atomic_get(&window_open)) {
		/* Chi trong cua so ghep (nguoi dung vua bam nut tren hub) */
		return BT_GATT_ERR(BT_ATT_ERR_AUTHORIZATION);
	}
	bcast_source_join_info(v);

	if (offset == 0) {
		key = k_spin_lock(&lock);
		if (!is_helmet_locked(conn)) {
			for (size_t i = 0; i < ARRAY_SIZE(helmets); i++) {
				if (helmets[i] == NULL) {
					helmets[i] = bt_conn_ref(conn);
					pending_helmet = helmets[i];
					fresh = true;
					break;
				}
			}
		}
		k_spin_unlock(&lock, key);
		if (fresh) {
			k_work_submit(&helmet_work);
		}
	}
	return bt_gatt_attr_read(conn, attr, buf, len, offset, v, sizeof(v));
}

/* Dich vu tinh: co trong co so du lieu GATT ngay tu luc build (Database Hash on dinh) */
BT_GATT_SERVICE_DEFINE(bhs_svc,
	BT_GATT_PRIMARY_SERVICE(&bhs_uuid),
	BT_GATT_CHARACTERISTIC(&join_uuid.uuid, BT_GATT_CHRC_READ, BT_GATT_PERM_READ_ENCRYPT,
			       join_read, NULL, NULL),
);

/* ---------------- Quang ba cua so ghep ---------------- */

static const uint8_t pair_svc[] = {BHS_UUID_SVC_VAL, BHS_PROTO_VER, BHS_FLAG_PAIRING};

/* KHONG co ten va KHONG co co "general discoverable": mu nhan ra hub bang Service Data. Truoc day
 * co ten "Bike_Hub" -> trong 60 s cua so ghep, dien thoai / may tinh bang thay HAI "Bike_Hub" (moi
 * bo quang ba mot dia chi RPA rieng) va co the ket noi nham vao bo quang ba nay (do 23/10/2026).
 */
static const struct bt_data ad_pair[] = {
	BT_DATA_BYTES(BT_DATA_FLAGS, BT_LE_AD_NO_BREDR),
	BT_DATA(BT_DATA_SVC_DATA128, pair_svc, sizeof(pair_svc)),
};

/* Controller tu dung bo quang ba co the ket noi khi co ket noi den: bat lai cho mu ke tiep */
static void adv_work_fn(struct k_work *w)
{
	int err;

	ARG_UNUSED(w);
	if (!atomic_get(&window_open) || adv_pair == NULL) {
		return;
	}
	err = bt_le_ext_adv_start(adv_pair, BT_LE_EXT_ADV_START_DEFAULT);
	if (err && err != -EALREADY) {
		LOG_WRN("Pairing advertising start failed (%d) - retry", err);
		k_work_reschedule(&kick_work, K_MSEC(500)); /* het o ket noi: thu lai */
	}
}

static void adv_connected(struct bt_le_ext_adv *adv, struct bt_le_ext_adv_connected_info *info)
{
	ARG_UNUSED(adv);
	ARG_UNUSED(info);
	k_work_submit(&pair_adv_work);
}

static struct bt_le_ext_adv_cb pair_adv_cb = {
	.connected = adv_connected,
};

/* ---------------- Mu da doc Join Info ---------------- */

static void helmet_work_fn(struct k_work *w)
{
	k_spinlock_key_t key = k_spin_lock(&lock);
	struct bt_conn *conn = pending_helmet;
	char addr[BT_ADDR_LE_STR_LEN];

	ARG_UNUSED(w);
	pending_helmet = NULL;
	k_spin_unlock(&lock, key);
	if (conn == NULL) {
		return;
	}

	atomic_inc(&joined_window);
	joined_total++;
	bt_addr_le_to_str(bt_conn_get_dst(conn), addr, sizeof(addr));
	LOG_INF("Helmet %s joined (%u in this window)", addr, (unsigned)atomic_get(&joined_window));
	hub_on_helmet(conn);
	hub_tone(HUB_TONE_HELMET_JOINED);
	/* Am "dang tim" lap lai sau am bao vao */
	k_work_reschedule(&kick_work, K_MSEC(HELMET_LINK_MS));
}

/* Ngat ho mu da doc xong ma chua tu ngat; bat lai am / quang ba cua so */
static void kick_work_fn(struct k_work *w)
{
	struct bt_conn *list[MAX_HELMET_LINKS];
	k_spinlock_key_t key;
	size_t n = 0;

	ARG_UNUSED(w);
	key = k_spin_lock(&lock);
	for (size_t i = 0; i < ARRAY_SIZE(helmets); i++) {
		if (helmets[i] != NULL) {
			list[n++] = bt_conn_ref(helmets[i]);
		}
	}
	k_spin_unlock(&lock, key);
	for (size_t i = 0; i < n; i++) {
		(void)bt_conn_disconnect(list[i], BT_HCI_ERR_REMOTE_USER_TERM_CONN);
		bt_conn_unref(list[i]);
	}
	if (atomic_get(&window_open)) {
		hub_tone(HUB_TONE_PAIR_SEARCH);
		k_work_submit(&pair_adv_work);
	}
}

void bhs_conn_disconnected(struct bt_conn *conn)
{
	k_spinlock_key_t key = k_spin_lock(&lock);
	struct bt_conn *drop = NULL;

	for (size_t i = 0; i < ARRAY_SIZE(helmets); i++) {
		if (helmets[i] == conn) {
			drop = helmets[i];
			helmets[i] = NULL;
		}
	}
	if (pending_helmet == drop) {
		pending_helmet = NULL;
	}
	k_spin_unlock(&lock, key);
	if (drop != NULL) {
		bt_conn_unref(drop);
	}
	if (atomic_get(&window_open)) {
		k_work_submit(&pair_adv_work);
	}
}

bool bhs_is_helmet(const struct bt_conn *conn)
{
	k_spinlock_key_t key = k_spin_lock(&lock);
	const bool r = is_helmet_locked(conn);

	k_spin_unlock(&lock, key);
	return r;
}

/* ---------------- Cua so ghep ---------------- */

static void close_work_fn(struct k_work *w)
{
	const atomic_val_t n = atomic_get(&joined_window);

	ARG_UNUSED(w);
	if (!atomic_cas(&window_open, 1, 0)) {
		return;
	}
	if (adv_pair != NULL) {
		(void)bt_le_ext_adv_stop(adv_pair);
	}
	LOG_INF("Helmet pairing window closed: %d helmet(s) joined", (int)n);
	hub_tone(n > 0 ? HUB_TONE_PAIR_END : HUB_TONE_FAIL);
}

void bhs_pair_start(void)
{
	if (atomic_cas(&window_open, 0, 1)) {
		atomic_set(&joined_window, 0);
		LOG_INF("Helmet pairing window OPEN for %d s - on each helmet: Power short, then hold "
			"Call 2 s",
			PAIR_WINDOW_S);
	} else {
		LOG_INF("Helmet pairing window extended to %d s", PAIR_WINDOW_S);
	}
	hub_tone(HUB_TONE_PAIR_SEARCH);
	k_work_submit(&pair_adv_work);
	k_work_reschedule(&close_work, K_SECONDS(PAIR_WINDOW_S));
}

void bhs_pair_cancel(void)
{
	if (atomic_get(&window_open)) {
		LOG_INF("Helmet pairing window cancelled");
		k_work_reschedule(&close_work, K_NO_WAIT);
	}
}

bool bhs_pair_active(void)
{
	return atomic_get(&window_open) != 0;
}

int bhs_init(void)
{
	static const struct bt_le_adv_param param = BT_LE_ADV_PARAM_INIT(
		BT_LE_ADV_OPT_CONN | BT_LE_ADV_OPT_EXT_ADV, BT_GAP_ADV_FAST_INT_MIN_2,
		BT_GAP_ADV_FAST_INT_MAX_2, NULL);
	int err;

	err = bt_le_ext_adv_create(&param, &pair_adv_cb, &adv_pair);
	if (err) {
		LOG_ERR("Pairing advertising set create failed (%d)", err);
		return err;
	}
	err = bt_le_ext_adv_set_data(adv_pair, ad_pair, ARRAY_SIZE(ad_pair), NULL, 0);
	if (err) {
		LOG_ERR("Pairing advertising data failed (%d)", err);
	}
	return err;
}

void bhs_print(const struct shell *sh)
{
	shell_print(sh, "Pairing   : window %s, helmets joined %u total (%d this window)",
		    atomic_get(&window_open) ? "OPEN" : "closed", joined_total,
		    (int)atomic_get(&joined_window));
}
```

## src/bike.h
```c
/*
 * Bike hub (apps/bike) - khai bao dung chung.
 * Thiet ke: docs/BIKE_HUB_THIET_KE.md
 *
 *   main.c         : khoi dong BT, quang ba cho dien thoai, ket noi / bao mat, cai dat, shell
 *   phone_sink.c   : BAP Unicast Server (chi chieu nhan): dien thoai gui nhac LC3 qua CIS
 *   bcast_source.c : BAP Broadcast Source (Auracast): phat lai nguyen khung LC3 cho moi mu o gan:
 *                    BIG 20 ms 1 BIS stereo (mac dinh) hoac BIG 10 ms 2 BIS trai / phai;
 *                    hang doi bu troi clock, khung im lang
 *   bhs.c          : Bike Hub Service + cua so ghep mu 60 s: mu doc broadcast ID / dia chi / ma
 *   hub_ui.c       : 4 nut, am bao qua loa, bat / tat nguon (board giong het mu)
 *
 * Hub khong giai ma / ma hoa lai am thanh: khung LC3 tu dien thoai duoc chuyen thang sang BIS.
 * Vi vay cau hinh LC3 cua BIG phai trung voi cau hinh dien thoai chon (48 kHz, 10 ms, cung
 * so octet moi khung); bcast_source.c tu tao lai BIG khi dien thoai doi so octet.
 */

#ifndef BIKE_H_
#define BIKE_H_

#include <stdbool.h>
#include <stdint.h>

#include <zephyr/kernel.h>
#include <zephyr/bluetooth/conn.h>
#include <zephyr/bluetooth/uuid.h>
#include <zephyr/shell/shell.h>
#include <zephyr/sys/util.h>

/* Cau hinh LC3 hub nhan tu dien thoai va phat lai (BAP 48_4 mac dinh) */
#define BIKE_FREQ_HZ        48000
#define BIKE_FRAME_US       10000
#define BIKE_OCTETS_MIN     100 /* 48_2 */
#define BIKE_OCTETS_MAX     155 /* 48_6 */
#define BIKE_OCTETS_DEFAULT 120 /* 48_4: dien thoai thuong chon cho nhac */

/* Kenh: bit 0 = trai (FL, BIS 1), bit 1 = phai (FR, BIS 2) */
#define BIKE_CH_L BIT(0)
#define BIKE_CH_R BIT(1)

/* ---------------- phone_sink.c ---------------- */

int phone_sink_register(void); /* TRUOC bt_enable(): PACS + ASCS vao GATT */
int phone_sink_init(void);     /* sau bt_enable() + settings_load() */
bool phone_sink_streaming(void);
void phone_sink_print(const struct shell *sh);
void phone_sink_log_status(void); /* heartbeat: SDU CIS nhan / mat trong 10 s vua qua */

/* ---------------- bcast_source.c ---------------- */

int bcast_source_init(void); /* sau bt_enable() + settings_load(): tao va bat dau BIG */

/* phone_sink.c (bt_rx): cap khung LC3 cua CUNG mot khoang 10 ms cho BIS trai va phai (luon gui
 * cung nhau de hai BIS khong lech nhau). NULL: kenh do bi mat goi tu dien thoai (hub lap lai khung
 * truoc mot lan, sau do phat im lang). len = so octet moi khung.
 */
void bcast_source_push_pair(const uint8_t *left, const uint8_t *right, uint16_t len);

/* phone_sink.c: luong tu dien thoai bat dau (octets = so octet moi kenh) / ket thuc */
void bcast_source_phone_started(uint16_t octets);
void bcast_source_phone_stopped(void);

enum bike_code_mode {
	BIKE_CODE_RANDOM, /* mac dinh: 16 byte ngau nhien, mu nhan qua BHS (khong ai phai go) */
	BIKE_CODE_TEXT,   /* chuoi tu dat (thu nghiem) */
	BIKE_CODE_OPEN,   /* khong ma hoa */
};
/* Luu + tao lai BIG. Doi ma thi cac mu da ghep phai ghep lai (giu nut "vao xe"). */
int bcast_source_set_code(enum bike_code_mode mode, const char *text);
int bcast_source_set_rtn(uint8_t rtn);       /* so lan phat lai moi PDU cua BIS; luu + tao lai */
/* Chu ky BIG: 20 = 1 BIS stereo, BN 2 (mac dinh); 10 = 2 BIS trai / phai. Luu + tao lai */
int bcast_source_set_isoint(uint8_t ms);
uint8_t bcast_source_iso_ms(void); /* chu ky BIG dang chay (10 / 20 ms) */
void bcast_source_print(const struct shell *sh);
void bcast_source_log_status(void);
/* Goi bt_rx (BHS): dien BHS_JOIN_INFO_LEN byte thong tin vao xe */
void bcast_source_join_info(uint8_t *out);

/* ---------------- bhs.c: Bike Hub Service (cung UUID voi apps/main/src/hub_link.c) ---------------- */

#define BHS_UUID_SVC_VAL  BT_UUID_128_ENCODE(0x0eed0101, 0x080c, 0x4225, 0xa3d0, 0xf91ce86a80c2)
#define BHS_UUID_JOIN_VAL BT_UUID_128_ENCODE(0x0eed0102, 0x080c, 0x4225, 0xa3d0, 0xf91ce86a80c2)
#define BHS_PROTO_VER     1
#define BHS_FLAG_PAIRING  BIT(0) /* trong Service Data quang ba: cua so ghep dang mo */
/* Join Info: [0] ver, [1..3] broadcast ID (LE24), [4] kieu dia chi, [5..10] dia chi bo phat
 * broadcast, [11] SID, [12] do dai ma (0 = mo), [13..28] ma broadcast (16 byte)
 */
#define BHS_JOIN_INFO_LEN 29

int bhs_init(void);
void bhs_pair_start(void);  /* mo cua so ghep mu 60 s (goi lai: gia han) */
void bhs_pair_cancel(void); /* dong ngay */
bool bhs_pair_active(void);
bool bhs_is_helmet(const struct bt_conn *conn); /* ket noi nay la mu dang ghep */
void bhs_conn_disconnected(struct bt_conn *conn);
void bhs_print(const struct shell *sh);

/* ---------------- hub_ui.c ---------------- */

enum hub_tone {
	HUB_TONE_POWER_ON,
	HUB_TONE_POWER_OFF,
	HUB_TONE_CONNECTED,
	HUB_TONE_DISCONNECTED,
	HUB_TONE_PAIR_SEARCH, /* lap: cua so ghep mu dang mo */
	HUB_TONE_HELMET_JOINED,
	HUB_TONE_PAIR_END, /* dong cua so, co it nhat 1 mu */
	HUB_TONE_FAIL,     /* dong cua so, khong co mu nao */
	HUB_TONE_STATUS_OK,
	HUB_TONE_STATUS_NO_LINK,
	HUB_TONE_UNPAIR,
	HUB_TONE_COUNT,
};

enum hub_gesture {
	HUB_G_STATUS,    /* Power ngan */
	HUB_G_POWER_OFF, /* Power giu 3 s */
	HUB_G_PAIR,      /* Power ngan -> giu Vol+ 2 s */
	HUB_G_UNPAIR,    /* Vol+ va Vol- giu 5 s */
	HUB_G_CALL,      /* Call ngan */
};

int hub_ui_init(void);
bool hub_power_boot_check(void); /* dau main(): thuc tu System OFF thi phai giu Power 2 s */
FUNC_NORETURN void hub_power_off(void);
void hub_tone(enum hub_tone t);
void hub_tone_stop(void);

/* ---------------- main.c ---------------- */

void hub_gesture(enum hub_gesture g); /* goi tu thread hub_ui */
void hub_on_helmet(struct bt_conn *conn); /* BHS: ket noi nay la mu (khong phai dien thoai) */
void hub_bt_shutdown(void);             /* tat may: ngat moi ket noi, dung quang ba */

#endif /* BIKE_H_ */
```

## src/nav_hub.c
```c
/*
 * Bike hub - che do Dinh vi (NAV), ban don gian: xe chi PHAN XA, khong tinh gi.
 * Thiet ke: docs/HELMET_NAV_DINH_VI.md
 *
 *   Bat / tat: Call ngan tren hub, hoac "bike nav on|off".
 *   Khi bat: phat quang ba Dinh vi (Service Data {UUID 0eed0201, ver, loai = xe, ma}) va bat vai
 *   tro CS REFLECTOR cho moi ket noi den. Mu (apps/main nav.c) thay quang ba thi ket noi toi
 *   xe, ma hoa roi TU tao cau hinh CS, bat CS Security, bat do va TU tinh khoang cach (mu =
 *   central = CS initiator, IPT). Xe khong co dich vu GATT nao cho Dinh vi.
 *
 *   Trong luc Dinh vi, xe TAM DUNG Auracast (BIG): BIG 10 ms, ca khi chi phat khung im lang, lam
 *   phan lon thu tuc CS mu-xe bi huy (do 22/10/2026: ~1 thu tuc thanh cong moi 10-30 s, trong khi
 *   mu-mu khong co BIG thi gan nhu thu tuc nao cung xong). "bike nav big keep" de giu BIG.
 *
 *   Xe nhan ra mot ket noi la mu Dinh vi khi mu tao cau hinh CS voi xe (su kien LE CS Config
 *   Complete o phia xe). Luc do goi hub_on_helmet() de bo ket noi khoi luong dien thoai (mu da
 *   ghep co the vao qua bo quang ba dien thoai: cung identity). Tat che do -> ngat cac mu nay.
 *
 * Luong: callback Bluetooth (bt_rx) chi ghi lai; lenh HCI dong bo (cai dat mac dinh CS, quang ba)
 * chay trong system workqueue.
 */

#include <errno.h>
#include <string.h>

#include <zephyr/kernel.h>
#include <zephyr/bluetooth/bluetooth.h>
#include <zephyr/bluetooth/conn.h>
#include <zephyr/bluetooth/cs.h>
#include <zephyr/bluetooth/hci.h>
#include <zephyr/logging/log.h>
#include <zephyr/shell/shell.h>
#include <zephyr/spinlock.h>
#include <zephyr/sys/atomic.h>

#include "bike.h"
#include "nav_proto.h"

LOG_MODULE_REGISTER(nav_hub, LOG_LEVEL_INF);

#define MAX_HELMETS  CONFIG_BT_CTLR_SDC_CS_COUNT
#define ADV_INT_MIN  0x00A0 /* 100 ms */
#define ADV_INT_MAX  0x00F0 /* 150 ms */
#define ADV_CHECK_MS 2000   /* bat lai quang ba neu controller da dung (sau ket noi) */

struct helmet {
	struct bt_conn *conn; /* giu 1 ref */
	bool running;
	uint32_t n_ok;
	uint32_t n_abort;
	uint32_t aborted_pc;
};

static struct k_spinlock lock;
static struct helmet helmets[MAX_HELMETS];
static struct bt_conn *pending[CONFIG_BT_MAX_CONN]; /* cho bat vai tro phan xa (giu ref) */
static atomic_t enabled;
static atomic_t want_on;  /* lenh bat / tat moi nhat (nut, shell) */
static atomic_t keep_big; /* 1: khong tam dung Auracast khi Dinh vi */
static struct bt_le_ext_adv *adv_nav;
static uint8_t nav_svc[NAV_ADV_LEN];

static void setup_fn(struct k_work *w);
static void adv_fn(struct k_work *w);
static void mode_fn(struct k_work *w);
static K_WORK_DEFINE(setup_work, setup_fn);
static K_WORK_DELAYABLE_DEFINE(adv_work, adv_fn);
static K_WORK_DEFINE(mode_work, mode_fn);

static const struct bt_data ad_nav[] = {
	BT_DATA_BYTES(BT_DATA_FLAGS, (BT_LE_AD_GENERAL | BT_LE_AD_NO_BREDR)),
	BT_DATA(BT_DATA_SVC_DATA128, nav_svc, sizeof(nav_svc)),
};

/* ---------------- Tien ich ---------------- */

static struct helmet *helmet_of(const struct bt_conn *conn)
{
	for (int i = 0; i < MAX_HELMETS; i++) {
		if (helmets[i].conn != NULL && helmets[i].conn == conn) {
			return &helmets[i];
		}
	}
	return NULL;
}

static const char *addr_str(const struct bt_conn *conn, char *buf, size_t len)
{
	bt_addr_le_to_str(bt_conn_get_dst(conn), buf, len);
	return buf;
}

/* ---------------- Work (sysworkq) ---------------- */

/* Bat vai tro phan xa cho cac ket noi moi (lenh HCI dong bo: khong goi trong bt_rx) */
static void setup_fn(struct k_work *w)
{
	const struct bt_le_cs_set_default_settings_param p = {
		.enable_initiator_role = false,
		.enable_reflector_role = true,
		.cs_sync_antenna_selection = BT_LE_CS_ANTENNA_SELECTION_OPT_REPETITIVE,
		.max_tx_power = BT_HCI_OP_LE_CS_MAX_MAX_TX_POWER,
	};

	ARG_UNUSED(w);
	for (size_t i = 0; i < ARRAY_SIZE(pending); i++) {
		k_spinlock_key_t key = k_spin_lock(&lock);
		struct bt_conn *c = pending[i];

		pending[i] = NULL;
		k_spin_unlock(&lock, key);
		if (c == NULL) {
			continue;
		}
		if (atomic_get(&enabled)) {
			const int err = bt_le_cs_set_default_settings(c, &p);

			if (err) {
				LOG_WRN("NAV: CS reflector setup failed (%d)", err);
			}
		}
		bt_conn_unref(c);
	}
}

/* Controller dung bo quang ba co the ket noi khi co ket noi: kiem tra dinh ky va bat lai.
 * Dang chay thi bt_le_ext_adv_start tra -EALREADY ngay (khong gui HCI).
 */
static void adv_fn(struct k_work *w)
{
	int err;

	ARG_UNUSED(w);
	if (adv_nav == NULL || !atomic_get(&enabled)) {
		return;
	}
	err = bt_le_ext_adv_start(adv_nav, BT_LE_EXT_ADV_START_DEFAULT);
	if (err && err != -EALREADY) {
		LOG_DBG("NAV advertising start failed (%d) - retry", err);
	}
	k_work_reschedule(&adv_work, K_MSEC(ADV_CHECK_MS));
}

static void disconnect_helmets(void)
{
	for (int i = 0; i < MAX_HELMETS; i++) {
		struct bt_conn *c;
		k_spinlock_key_t key = k_spin_lock(&lock);

		c = helmets[i].conn != NULL ? bt_conn_ref(helmets[i].conn) : NULL;
		k_spin_unlock(&lock, key);
		if (c != NULL) {
			(void)bt_conn_disconnect(c, BT_HCI_ERR_REMOTE_USER_TERM_CONN);
			bt_conn_unref(c);
		}
	}
}

static void mode_fn(struct k_work *w)
{
	const bool on = atomic_get(&want_on) != 0;

	ARG_UNUSED(w);
	if (on == (atomic_get(&enabled) != 0) || adv_nav == NULL) {
		return;
	}
	atomic_set(&enabled, on);
	if (on) {
		LOG_INF("Navigation mode ON - advertising; helmets measure their distance to the bike");
		hub_tone(HUB_TONE_NAV_ON);
		if (!atomic_get(&keep_big)) {
			bcast_source_pause(true); /* nhuong radio cho Channel Sounding */
		}
		k_work_reschedule(&adv_work, K_NO_WAIT);
	} else {
		(void)k_work_cancel_delayable(&adv_work);
		(void)bt_le_ext_adv_stop(adv_nav);
		disconnect_helmets();
		bcast_source_pause(false);
		LOG_INF("Navigation mode OFF");
		hub_tone(HUB_TONE_NAV_OFF);
	}
}

/* ---------------- Callback Bluetooth (bt_rx) ---------------- */

static void connected(struct bt_conn *conn, uint8_t err)
{
	struct bt_conn_info info;
	k_spinlock_key_t key;

	if (err || !atomic_get(&enabled) || bt_conn_get_info(conn, &info) != 0 ||
	    info.role != BT_CONN_ROLE_PERIPHERAL) {
		return;
	}
	/* Chua biet la mu hay dien thoai: bat phan xa cho moi ket noi den (vo hai voi dien thoai) */
	key = k_spin_lock(&lock);

	for (size_t i = 0; i < ARRAY_SIZE(pending); i++) {
		if (pending[i] == NULL) {
			pending[i] = bt_conn_ref(conn);
			break;
		}
	}
	k_spin_unlock(&lock, key);
	k_work_submit(&setup_work);
	k_work_reschedule(&adv_work, K_MSEC(100));
}

static void disconnected(struct bt_conn *conn, uint8_t reason)
{
	char addr[BT_ADDR_LE_STR_LEN];
	struct bt_conn *drop = NULL;
	struct helmet h = {0};
	k_spinlock_key_t key = k_spin_lock(&lock);

	for (int i = 0; i < MAX_HELMETS; i++) {
		if (helmets[i].conn != NULL && helmets[i].conn == conn) {
			h = helmets[i];
			drop = helmets[i].conn;
			memset(&helmets[i], 0, sizeof(helmets[i]));
			break;
		}
	}
	k_spin_unlock(&lock, key);
	if (drop == NULL) {
		return;
	}
	LOG_INF("NAV: helmet %s left (reason 0x%02x, %u procedures, %u aborted)",
		addr_str(conn, addr, sizeof(addr)), reason, h.n_ok, h.n_abort);
	bt_conn_unref(drop);
}

/* Mu vua tao cau hinh CS voi xe: day chinh la mu Dinh vi */
static void config_cb(struct bt_conn *conn, uint8_t status, struct bt_conn_le_cs_config *cfg)
{
	char addr[BT_ADDR_LE_STR_LEN];
	bool added = false;
	k_spinlock_key_t key;

	if (status != BT_HCI_ERR_SUCCESS) {
		LOG_WRN("NAV: CS config with %s failed (0x%02x)", addr_str(conn, addr, sizeof(addr)),
			status);
		return;
	}
	key = k_spin_lock(&lock);
	if (helmet_of(conn) == NULL) {
		for (int i = 0; i < MAX_HELMETS; i++) {
			if (helmets[i].conn == NULL) {
				memset(&helmets[i], 0, sizeof(helmets[i]));
				helmets[i].conn = bt_conn_ref(conn);
				helmets[i].aborted_pc = UINT32_MAX;
				added = true;
				break;
			}
		}
	}
	k_spin_unlock(&lock, key);
	if (!added) {
		return;
	}
	LOG_INF("NAV: helmet %s is measuring its distance to the bike (bike = CS reflector, mode %u)",
		addr_str(conn, addr, sizeof(addr)), cfg->mode);
	hub_on_helmet(conn); /* khong phai dien thoai */
}

static void proc_enable_cb(struct bt_conn *conn, uint8_t status,
			   struct bt_conn_le_cs_procedure_enable_complete *p)
{
	struct helmet *h = helmet_of(conn);
	char addr[BT_ADDR_LE_STR_LEN];

	if (h == NULL || status != BT_HCI_ERR_SUCCESS) {
		return;
	}
	h->running = p->state == BT_CONN_LE_CS_PROCEDURES_ENABLED;
	LOG_INF("NAV: helmet %s ranging %s (procedure every %u conn events)",
		addr_str(conn, addr, sizeof(addr)), h->running ? "RUNNING" : "stopped",
		p->procedure_interval);
}

static void subevent_cb(struct bt_conn *conn, struct bt_conn_le_cs_subevent_result *r)
{
	struct helmet *h = helmet_of(conn);

	if (h == NULL) {
		return;
	}
	if (r->header.procedure_abort_reason != BT_HCI_LE_CS_PROCEDURE_ABORT_REASON_NO_ABORT ||
	    r->header.subevent_abort_reason != BT_HCI_LE_CS_SUBEVENT_ABORT_REASON_NO_ABORT) {
		if (h->aborted_pc != r->header.procedure_counter) {
			h->aborted_pc = r->header.procedure_counter;
			h->n_abort++;
		}
		return;
	}
	if (r->header.procedure_done_status == BT_CONN_LE_CS_PROCEDURE_COMPLETE) {
		h->n_ok++;
	}
}

BT_CONN_CB_DEFINE(nav_conn_cb) = {
	.connected = connected,
	.disconnected = disconnected,
	.le_cs_config_complete = config_cb,
	.le_cs_procedure_enable_complete = proc_enable_cb,
	.le_cs_subevent_data_available = subevent_cb,
};

/* ---------------- API ---------------- */

int nav_hub_init(void)
{
	static const struct bt_le_adv_param param =
		BT_LE_ADV_PARAM_INIT(BT_LE_ADV_OPT_CONN, ADV_INT_MIN, ADV_INT_MAX, NULL);
	bt_addr_le_t ids[CONFIG_BT_ID_MAX];
	size_t n = ARRAY_SIZE(ids);
	int err;

	bt_id_get(ids, &n);
	nav_adv_build(nav_svc, NAV_TYPE_BIKE, n > 0 ? nav_tag_of(&ids[0]) : 0);
	/* Legacy, co the ket noi: 27 B, it chiem radio hon extended */
	err = bt_le_ext_adv_create(&param, NULL, &adv_nav);
	if (err) {
		LOG_ERR("NAV advertising set create failed (%d)", err);
		return err;
	}
	err = bt_le_ext_adv_set_data(adv_nav, ad_nav, ARRAY_SIZE(ad_nav), NULL, 0);
	if (err) {
		LOG_ERR("NAV advertising data failed (%d)", err);
		return err;
	}
	LOG_INF("Navigation mode ready (Call short or \"bike nav on\")");
	return 0;
}

void nav_hub_set(bool on)
{
	atomic_set(&want_on, on);
	k_work_submit(&mode_work);
}

void nav_hub_toggle(void)
{
	nav_hub_set(!atomic_get(&want_on));
}

void nav_hub_log_status(void)
{
	char addr[BT_ADDR_LE_STR_LEN];

	if (!atomic_get(&enabled)) {
		return;
	}
	for (int i = 0; i < MAX_HELMETS; i++) {
		struct bt_conn *c;
		struct helmet h;
		k_spinlock_key_t key = k_spin_lock(&lock);

		c = helmets[i].conn != NULL ? bt_conn_ref(helmets[i].conn) : NULL;
		h = helmets[i];
		k_spin_unlock(&lock, key);
		if (c == NULL) {
			continue;
		}
		LOG_INF("nav: helmet %s %s, %u procedures, %u aborted", addr_str(c, addr, sizeof(addr)),
			h.running ? "RUNNING" : "setting up", h.n_ok, h.n_abort);
		bt_conn_unref(c);
	}
}

int nav_hub_shell(const struct shell *sh, size_t argc, char **argv)
{
	char addr[BT_ADDR_LE_STR_LEN];
	int n = 0;

	if (argc == 2 && (strcmp(argv[1], "on") == 0 || strcmp(argv[1], "off") == 0)) {
		nav_hub_set(strcmp(argv[1], "on") == 0);
		return 0;
	}
	if (argc == 3 && strcmp(argv[1], "big") == 0 &&
	    (strcmp(argv[2], "pause") == 0 || strcmp(argv[2], "keep") == 0)) {
		atomic_set(&keep_big, strcmp(argv[2], "keep") == 0);
		shell_print(sh, "Auracast during navigation: %s (from the next time navigation is "
			    "turned on)",
			    atomic_get(&keep_big) ? "kept" : "paused");
		return 0;
	}
	if (argc != 1) {
		shell_error(sh, "usage: bike nav [on|off|big <pause|keep>]");
		return -EINVAL;
	}
	shell_print(sh, "Nav       : %s, Auracast %s while navigating",
		    atomic_get(&enabled) ? "ON (advertising, CS reflector)"
					 : "off (Call short or bike nav on)",
		    atomic_get(&keep_big) ? "kept" : "paused");
	for (int i = 0; i < MAX_HELMETS; i++) {
		struct bt_conn *c;
		struct helmet h;
		k_spinlock_key_t key = k_spin_lock(&lock);

		c = helmets[i].conn != NULL ? bt_conn_ref(helmets[i].conn) : NULL;
		h = helmets[i];
		k_spin_unlock(&lock, key);
		if (c == NULL) {
			continue;
		}
		n++;
		shell_print(sh, "Helmet    : %s, %s, %u procedures, %u aborted",
			    addr_str(c, addr, sizeof(addr)), h.running ? "RUNNING" : "setting up",
			    h.n_ok, h.n_abort);
		bt_conn_unref(c);
	}
	if (n == 0) {
		shell_print(sh, "Helmet    : none (distances are computed and logged on the helmets)");
	}
	return 0;
}
```
