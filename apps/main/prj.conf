## CMakeLists.txt
```
cmake_minimum_required(VERSION 3.20.0)

# Lop 1-2 dung chung (lib/) la mot Zephyr module: moi lop mot thu vien, chi build module bat
# trong prj.conf (Kconfig cua lib/ nam trong menu "Modules")
set(ME54_LIB ${CMAKE_CURRENT_SOURCE_DIR}/../../lib)
list(APPEND ZEPHYR_EXTRA_MODULES ${ME54_LIB})

find_package(Zephyr REQUIRED HINTS $ENV{ZEPHYR_BASE})
project(helmet_main)

# Lop 3-4 cua mu: include theo duong dan tu src/ ("app/app.h", "features/phone/le_audio.h")
target_include_directories(app PRIVATE
  src
  ${ME54_LIB}/services/include
  ${ME54_LIB}/hal/include
  ${ME54_LIB}/core/include
  ${ME54_LIB}/proto/include)

add_subdirectory(src/app)                 # lop 4: ung dung
add_subdirectory(src/features/phone)      # lop 3: chuc nang
add_subdirectory(src/features/intercom)
add_subdirectory(src/features/broadcast)
add_subdirectory(src/features/thermo)
add_subdirectory(src/features/nav)
add_subdirectory(src/debug)               # chan doan
```

## Kconfig
```
# Tuy chon rieng cua apps/main. Dat khi build: make APP=apps/main EXTRA=-DCONFIG_HELMET_CAPTURE=y build
# (sysbuild chi chuyen tiep bien CONFIG_* toi image cua app, khong chuyen bien CMake tu dat).
# Kconfig cua lib/ (CONFIG_ME54_*) nam trong module me54_lib, nap qua Kconfig.zephyr.

config HELMET_CAPTURE
	bool "Ghi am thanh nhan duoc ra RTT kenh 1 (make audio)"
	help
	  debug/capture.c chep cac SDU LC3 nhan duoc ra RTT kenh 1 cho scripts/helmet_audio.py.
	  Ton HELMET_CAPTURE_BUF byte RAM (mac dinh 16 KB), nen mac dinh TAT de du RAM cho
	  che do Dinh vi (them 1 ket noi + Channel Sounding).

config HELMET_CAPTURE_BUF
	int "Bo dem RTT cho ghi am thanh (byte)"
	default 16384
	depends on HELMET_CAPTURE

source "Kconfig.zephyr"
```

## prj.conf
```kconfig
# ============================================================
#  Helmet (apps/main) - tai nghe LE Audio day du:
#  nghe nhac + dam thoai (CIS hai chieu) + nut cu chi + bat/tat + nhiet do
#  Thiet ke: docs/HELMET_THIET_KE_CHUC_NANG_MOI.md
# ============================================================

# ---- Log + shell qua SEGGER RTT (make rtt) va UART20 ----
CONFIG_LOG=y
CONFIG_LOG_MODE_DEFERRED=y
CONFIG_LOG_BUFFER_SIZE=4096
CONFIG_USE_SEGGER_RTT=y
CONFIG_SEGGER_RTT_BUFFER_SIZE_UP=4096
CONFIG_SEGGER_RTT_BUFFER_SIZE_DOWN=256
CONFIG_SHELL=y
CONFIG_SHELL_BACKEND_SERIAL=y
CONFIG_SHELL_BACKEND_RTT=y
CONFIG_SHELL_STACK_SIZE=3072
CONFIG_KERNEL_SHELL=y
CONFIG_THREAD_NAME=y
CONFIG_THREAD_MONITOR=y
CONFIG_THREAD_STACK_INFO=y
# Thoi gian CPU that cua tung thread: "helmet cpu" (va "kernel thread list")
CONFIG_THREAD_RUNTIME_STATS=y

# ---- Bluetooth LE co ban ----
CONFIG_BT=y
CONFIG_BT_PERIPHERAL=y
CONFIG_BT_DEVICE_NAME="Helmet_1"
CONFIG_BT_EXT_ADV=y
CONFIG_BT_HCI_ERR_TO_STR=y
CONFIG_BT_SECURITY_ERR_TO_STR=y
CONFIG_BT_USER_PHY_UPDATE=y
CONFIG_BT_GAP_AUTO_UPDATE_CONN_PARAMS=n
CONFIG_BT_PERIPHERAL_PREF_MIN_INT=50
CONFIG_BT_PERIPHERAL_PREF_MAX_INT=70
CONFIG_BT_PERIPHERAL_PREF_LATENCY=0
CONFIG_BT_PERIPHERAL_PREF_TIMEOUT=400

# ---- Bao mat + luu bond / cai dat vao RRAM (phan vung storage, ZMS) ----
CONFIG_BT_SMP=y
# Sua loi turnoff, reset lai khong lien tuc mat ket noi
CONFIG_BT_SMP_ALLOW_UNAUTH_OVERWRITE=y
CONFIG_BT_PRIVACY=y
CONFIG_BT_MAX_PAIRED=6
CONFIG_BT_KEYS_OVERWRITE_OLDEST=y
CONFIG_BT_SETTINGS=y
CONFIG_SETTINGS=y
CONFIG_FLASH=y
CONFIG_FLASH_MAP=y
CONFIG_ZMS=y
# Ghi RRAM dong bo voi radio qua MPSL timeslot. Mac dinh bo dem ghi 32 dong -> moi lan ghi xin
# 8,1 ms radio trong lien tuc; khi dang nghe CIS / BIG (chu ky 10 ms) khong co khoang do -> moi lan
# luu settings bi treo toi 24 s (gap tren hub 20/10/2026). 1 dong (16 B): chi can 0,6 ms moi lan.
CONFIG_NRF_RRAM_WRITE_BUFFER_SIZE=1

# ---- GATT (client cho MCP/TBS, dynamic DB cho dich vu LE Audio) ----
CONFIG_BT_GATT_CLIENT=y
CONFIG_BT_GATT_AUTO_DISCOVER_CCC=y
CONFIG_BT_GATT_DYNAMIC_DB=y
# Ghi dai (Prepare Write): ASE metadata 64 B va BASS Add Source (metadata subgroup) co the dai
# hon ATT MTU 65 B -> dien thoai chia nhieu goi. ASCS bat buoc du cho gia tri ASE lon nhat.
CONFIG_BT_ATT_PREPARE_COUNT=4
CONFIG_BT_ATT_TX_COUNT=20
CONFIG_UTF8=y

# ---- LE Audio: nghe (2 ASE sink) + noi (1 ASE source) ----
CONFIG_BT_AUDIO=y
CONFIG_BT_ISO_PERIPHERAL=y
# 3 kenh cho dien thoai (ASCS) + 1 CIS hai chieu khi la master intercom
CONFIG_BT_ISO_MAX_CHAN=4
# So SDU gui di toi da nam trong controller: host (phieu theo doi) va controller (o chua)
# PHAI bang nhau, neu khong Zephyr canh bao va mot ben bi phi. 3 = mac dinh cua SDC, du cho
# voice_tx (moi 2 SDU + 1 du phong khi CPU ban luc goi dien), khong lam tang do tre.
CONFIG_BT_ISO_TX_BUF_COUNT=3
CONFIG_BT_CTLR_SDC_ISO_TX_HCI_BUFFER_COUNT=3
CONFIG_BT_BAP_UNICAST_SERVER=y
# Metadata dien thoai gui kem Enable: Streaming Contexts (4 B) + CCID List khi goi dien (3 B)...
# Mac dinh 4 B -> ASCS tu choi Enable (0x0D) va dien thoai thu lai mai, cuoc goi khong co tieng.
# 64 B: metadata subgroup cua broadcast (Program Info, ngon ngu...) trong BASS Add Source / BASE.
CONFIG_BT_AUDIO_CODEC_CFG_MAX_METADATA_SIZE=64
# Codec config cua BIS = subgroup (tan so, khung, octet, vi tri) + muc BIS (vi tri): > 19 B mac dinh
CONFIG_BT_AUDIO_CODEC_CFG_MAX_DATA_SIZE=32
CONFIG_BT_ASCS=y
CONFIG_BT_ASCS_MAX_ASE_SNK_COUNT=2
CONFIG_BT_ASCS_MAX_ASE_SRC_COUNT=1
CONFIG_BT_PAC_SNK=y
CONFIG_BT_PAC_SNK_LOC=y
CONFIG_BT_PAC_SRC=y
CONFIG_BT_PAC_SRC_LOC=y
CONFIG_BT_CAP_ACCEPTOR=y
CONFIG_BT_TMAP=y
CONFIG_BT_VCP_VOL_REND=y
CONFIG_BT_MCC=y

# ---- Cuoc goi: CCP / TBS client (chi GTBS) + MICP (tat micro tu dien thoai) ----
CONFIG_BT_CCP_CALL_CONTROL_CLIENT=y
CONFIG_BT_TBS_CLIENT_GTBS=y
CONFIG_BT_TBS_CLIENT_MAX_CALLS=2
CONFIG_BT_TBS_CLIENT_ACCEPT_CALL=y
CONFIG_BT_TBS_CLIENT_TERMINATE_CALL=y
CONFIG_BT_TBS_CLIENT_INCOMING_CALL=y
CONFIG_BT_TBS_CLIENT_CALL_FRIENDLY_NAME=y
# URI cuoc goi (tel:/sip:...) dai hon 30 B (mac dinh) bi bo qua trong danh sach cuoc goi
CONFIG_BT_TBS_MAX_URI_LENGTH=64
CONFIG_BT_MICP_MIC_DEV=y

# ---- LC3 (giai ma + ma hoa, liblc3 dung FPU) + I2S + PDM ----
CONFIG_FPU=y
CONFIG_FPU_SHARING=y
CONFIG_LIBLC3=y
# Giam on (voice_dsp.c): FFT thuc 512 diem arm_rfft_fast_f32 thay FFT phuc tu viet
CONFIG_CMSIS_DSP=y
CONFIG_CMSIS_DSP_TRANSFORM=y
CONFIG_I2S=y
CONFIG_AUDIO=y
CONFIG_AUDIO_DMIC=y

# ---- Nut nhan (gpio-keys -> input) ----
CONFIG_INPUT=y

# ---- Nguon: System OFF, nguyen nhan reset, tam dung UART, do VDD ----
CONFIG_POWEROFF=y
CONFIG_HWINFO=y
CONFIG_PM_DEVICE=y
CONFIG_ADC=y

# ---- Cam bien nhiet MLX90632 tren I2C bit-bang (i2c-sensor) ----
CONFIG_I2C=y

# ---- Stack / uu tien ----
CONFIG_MAIN_STACK_SIZE=3072
CONFIG_MAIN_THREAD_PRIORITY=4
CONFIG_SYSTEM_WORKQUEUE_STACK_SIZE=2560

# ---- Intercom mu-mu (docs/HELMET_THIET_KE_INTERCOM.md, ban master/slave chon bang nut) ----
# Mu nao cung co the la master (central + peripheral cho dien thoai) hoac slave (2 peripheral:
# dien thoai + master). Che do Dinh vi (features/nav) them 1 central toi xe -> 4 ket noi: toi da
# 2 peripheral, 2 central (SDC: central = MAX_CONN - PERIPHERAL_COUNT).
CONFIG_BT_CENTRAL=y
CONFIG_BT_MAX_CONN=4
CONFIG_BT_CTLR_SDC_PERIPHERAL_COUNT=2
# Du lieu quang ba khi la slave dang cho (~66 B: LE Audio + Service Data cua HIS)
CONFIG_BT_CTLR_ADV_DATA_LEN_MAX=191
# Am thanh mu-mu: master la BAP Unicast Client, 1 CIS hai chieu toi 2 ASE cua slave
CONFIG_BT_ISO_CENTRAL=y
CONFIG_BT_BAP_UNICAST_CLIENT=y
CONFIG_BT_GATT_AUTO_UPDATE_MTU=y
CONFIG_BT_BAP_UNICAST_CLIENT_ASE_SNK_COUNT=2
CONFIG_BT_BAP_UNICAST_CLIENT_ASE_SRC_COUNT=2
CONFIG_BT_BAP_UNICAST_CLIENT_GROUP_COUNT=1
CONFIG_BT_BAP_UNICAST_CLIENT_GROUP_STREAM_COUNT=2

# ---- Auracast: nghe chung nhac tu 1 dien thoai (docs/HELMET_AURACAST.md) ----
# Mu la BAP Broadcast Sink + Scan Delegator (BASS): dien thoai (Broadcast Assistant, "Chia se am
# thanh") chi cho mu luong broadcast can nghe, hoac mu tu quet (Power ngan -> giu Call 2 s).
CONFIG_BT_PER_ADV_SYNC=y
# Nhan thong tin dong bo PA qua ket noi ACL (PAST) tu dien thoai: khong phai tu quet
CONFIG_BT_PER_ADV_SYNC_TRANSFER_RECEIVER=y
CONFIG_BT_ISO_SYNC_RECEIVER=y
CONFIG_BT_BAP_SCAN_DELEGATOR=y
# 2 o Receive State: nguon cu chua bi dien thoai xoa van con cho cho nguon moi
CONFIG_BT_BAP_SCAN_DELEGATOR_RECV_STATE_COUNT=2
CONFIG_BT_BAP_BROADCAST_SINK=y
# Toi da 2 BIS (trai + phai) tu 1 subgroup; BASE co the co 2 subgroup (vd chat luong cao / chuan)
CONFIG_BT_BAP_BROADCAST_SNK_STREAM_COUNT=2
CONFIG_BT_BAP_BASS_MAX_SUBGROUPS=2
# Controller: 2 BIS nhan (mac dinh = BT_ISO_MAX_CHAN = 4 -> phi RAM)
CONFIG_BT_CTLR_SYNC_ISO_STREAM_MAX=2
CONFIG_BT_CTLR_SYNC_ISO_STREAM_COUNT=2
# Bo dem ISO nhan cua host: 2 BIS + CIS cung luc (mac dinh 1)
CONFIG_BT_ISO_RX_BUF_COUNT=4
# Thread bt_rx xu ly them lenh BASS + phan tich BASE (mac dinh 2200 B): du phong stack
CONFIG_BT_RX_STACK_SIZE=2560

# ---- Che do Dinh vi: Channel Sounding (Bluetooth 6.0), docs/HELMET_NAV_DINH_VI.md ----
# CS Inline PCT Transfer (IPT): ben ket noi (central) la khoi tao va tu tinh khoang cach, khong can
# Ranging Service (GATT). Mu do toi xe (mu = initiator, xe = reflector) va mu-mu (mu ma nho hon
# do, mu kia phan xa) -> controller ho tro ca hai vai tro, 2 lien ket co CS cung luc.
CONFIG_BT_CHANNEL_SOUNDING=y
CONFIG_BT_CTLR_SDC_CS_ROLE_BOTH=y
CONFIG_BT_CTLR_SDC_CS_COUNT=2
CONFIG_BT_CTLR_SDC_CS_MAX_ANTENNA_PATHS=1
CONFIG_BT_CTLR_SDC_CS_NUM_ANTENNAS=1
CONFIG_BT_CTLR_SDC_CS_STEP_MODE3=n
CONFIG_BT_CTLR_CHANNEL_SOUNDING_TEST=n
# Bat buoc cho CS enhancements (IPT)
CONFIG_BT_CTLR_EXTENDED_FEAT_SET=y
# Cho phep CS va ACL dung PHY khac nhau
CONFIG_BT_TRANSMIT_POWER_CONTROL=y
# Ket qua subevent rap lai trong host: 1 bo dem cho MOI thu tuc chay song song (mu-mu + mu-xe).
# Mode 2, 1 duong anten: ~8 B / buoc; subevent <= 5 ms (~40 buoc) ~ 350 B -> 1000 B du.
CONFIG_BT_CHANNEL_SOUNDING_REASSEMBLY_BUFFER_CNT=2
CONFIG_BT_CHANNEL_SOUNDING_REASSEMBLY_BUFFER_SIZE=1000
# Uoc luong khoang cach (IFFT). 512 diem: bo nho tam 4 KB (1024 diem: 8 KB)
CONFIG_BT_CS_DE=y
CONFIG_BT_CS_DE_512_NFFT=y
CONFIG_BT_CS_DE_MAX_NUM_ANTENNA_PATHS=1

# ---- CHAN DOAN TAM THOI (19/10/2026): vi sao Samsung khong chia se am thanh toi mu ----
# Log moi lan dien thoai doc / ghi thuoc tinh GATT (gatt_trace.c) + log debug cua BASS.
# Tat ca hai sau khi tim ra nguyen nhan.
CONFIG_BT_GATT_AUTHORIZATION_CUSTOM=y
CONFIG_BT_BAP_SCAN_DELEGATOR_LOG_LEVEL_DBG=y

# ---- Thu vien dung chung lib/ (lop 1-2; module lop tren tu chon module lop duoi) ----
# Dich vu: duong ra loa, chieu len cuoc goi, cu chi nut
CONFIG_ME54_SVC_AUDIO_OUT=y
CONFIG_ME54_SVC_VOICE_TX=y
CONFIG_ME54_SVC_BUTTONS=y
# HAL: LED trang thai, nguon (System OFF, VDD), cam bien nhiet
CONFIG_ME54_HAL_STATUS_LED=y
CONFIG_ME54_HAL_POWER=y
CONFIG_ME54_HAL_MLX90632=y
```

## boards/me54bs62_nrf54l15_cpuapp.overlay
```dts
/*
 * apps/main - chinh devicetree rieng cho app (board giu nguyen).
 *
 * PDM20: hang doi khoi da thu tu 4 (mac dinh) len 10 = 100 ms. Driver dung han PDM khi hang
 * day, nen hang lon cho phep thread giong noi cham thoang qua ma micro khong bi dung.
 * Khong vuot qua MIC_BLOCK_COUNT (12, mic_in.c) tru 2 khoi DMA dang giu.
 */
&pdm20 {
	queue-size = <10>;
};
```

## src/buttons.c
```c
/*
 * Helmet - nhan dang cu chi nut.
 *
 * gpio-keys (chong doi 30 ms) -> on_input (main.c) -> EVT_KEY_RAW
 * k_timer cua tung phim het gio (ISR)              -> EVT_KEY_TIMER
 * Bo dieu khien (thread main) goi buttons_handle() -> may trang thai tung phim
 *   -> app_gesture(phim, cu chi) ngay trong thread do (khong can khoa).
 *
 * Cu chi:
 *   G_SHORT     nha truoc 600 ms (neu phim co "dup" trong trang thai hien tai thi cho them
 *               350 ms xem co lan nhan thu hai khong)
 *   G_DOUBLE    lan nhan thu hai bat dau trong 350 ms sau lan nha dau
 *   G_LONG      giu toi 1 s (phat ngay luc do, khong cho nha)
 *   G_VERY_LONG giu toi 3 s
 *   G_REPEAT    Vol+/Vol- giu: lan dau sau 500 ms, sau do moi 250 ms
 *   G_COMBO_VOL Vol+ va Vol- cung nhan (cach nhau <= 200 ms) va giu 5 s
 *   G_SEQ_HOLD  to hop Power -> phim: bo dieu khien goi buttons_arm_seq() khi Power nhan ngan;
 *               lan nhan Vol/Call dau tien trong cua so do duoc "giu lai": giu du 2 s ->
 *               G_SEQ_HOLD (Vol: chon vai tro intercom, Call: tu tim / roi Auracast), nha som
 *               -> G_SHORT (1 nac am luong / Call ngan)
 * Nha trong khoang 600-1000 ms: khong phat gi (tranh nham ngan/giu).
 *
 * Moi lan hen gio tang "the he" (gen) cua phim; su kien hen gio mang gen cu (da bi huy
 * hoac hen lai) bi bo qua.
 */

#include <string.h>

#include <zephyr/kernel.h>
#include <zephyr/logging/log.h>
#include <zephyr/sys/util.h>

#include "helmet.h"

LOG_MODULE_REGISTER(buttons, LOG_LEVEL_INF);

#define T_SHORT_MAX    600
#define T_DOUBLE_GAP   350
#define T_LONG         1000
#define T_VERY_LONG    3000
#define T_REPEAT_START 500
#define T_REPEAT       250
#define T_COMBO        5000
#define T_COMBO_PAIR   200
#define T_SEQ_HOLD     2000

#define COMBO_TIMER KEY_COUNT

enum key_st {
	ST_IDLE,
	ST_DOWN1,  /* dang nhan lan 1 */
	ST_WAIT2,  /* da nha, cho lan nhan thu hai */
	ST_DOWN2,  /* dang nhan lan 2 */
	ST_HELD,   /* da phat G_LONG, dang giu */
	ST_HELD2,  /* da phat G_VERY_LONG, cho nha */
	ST_REPEAT, /* Vol: dang lap */
	ST_COMBO,  /* Vol+ va Vol- cung nhan */
	ST_SEQ,    /* Vol/Call nhan trong cua so to hop Power -> phim, cho du 2 s */
	ST_IGNORE, /* bo qua toi lan nha ke tiep */
};

struct key_sm {
	uint8_t st;
	bool dbl;
	uint32_t t_down;
	uint32_t gen;
	struct k_timer timer;
};

static struct key_sm keys[KEY_COUNT];
static struct k_timer combo_timer;
static uint32_t combo_gen;
static bool combo_fired;
static bool seq_armed;
static uint32_t seq_until;

static const char *const key_names[KEY_COUNT] = {"volup", "voldown", "call", "power"};
static const char *const gesture_names[G_COUNT] = {"short",  "double", "long",   "vlong",
						   "repeat", "combo",  "seqhold"};

static bool is_vol(uint8_t k)
{
	return k == KEY_VOL_UP || k == KEY_VOL_DOWN;
}

static void timer_expiry(struct k_timer *t)
{
	const uint32_t idx = (uint32_t)(uintptr_t)k_timer_user_data_get(t);
	const uint32_t gen = (idx == COMBO_TIMER) ? combo_gen : keys[idx].gen;

	app_post(EVT_KEY_TIMER, (uint8_t)idx, 0, gen);
}

static void start_timer(uint8_t k, uint32_t ms)
{
	keys[k].gen++;
	k_timer_start(&keys[k].timer, K_MSEC(ms), K_NO_WAIT);
}

static void stop_timer(uint8_t k)
{
	keys[k].gen++;
	k_timer_stop(&keys[k].timer);
}

static void emit(uint8_t k, uint8_t g)
{
	LOG_INF("Gesture %s %s", key_names[k], gesture_names[g]);
	app_gesture(k, g);
}

static void on_press(uint8_t k, uint32_t now)
{
	struct key_sm *s = &keys[k];

	switch (s->st) {
	case ST_IGNORE:
		return;
	case ST_WAIT2:
		stop_timer(k);
		s->st = ST_DOWN2;
		return;
	case ST_IDLE:
		break;
	default:
		return; /* su kien nhan lap (khong mong doi) */
	}

	/* To hop Power -> Vol/Call: chi lan nhan dau tien sau Power nhan ngan moi duoc tinh */
	if (seq_armed) {
		const bool in_window = (int32_t)(now - seq_until) <= 0;

		seq_armed = false;
		if ((is_vol(k) || k == KEY_CALL) && in_window) {
			s->st = ST_SEQ;
			s->t_down = now;
			start_timer(k, T_SEQ_HOLD);
			return;
		}
	}

	if (is_vol(k)) {
		const uint8_t other = (k == KEY_VOL_UP) ? KEY_VOL_DOWN : KEY_VOL_UP;
		struct key_sm *o = &keys[other];

		if (o->st == ST_DOWN1 && (now - o->t_down) <= T_COMBO_PAIR) {
			stop_timer(other);
			o->st = ST_COMBO;
			s->st = ST_COMBO;
			combo_fired = false;
			combo_gen++;
			k_timer_start(&combo_timer, K_MSEC(T_COMBO), K_NO_WAIT);
			return;
		}
	}

	s->st = ST_DOWN1;
	s->t_down = now;
	start_timer(k, is_vol(k) ? T_REPEAT_START : T_LONG);
}

static void on_release(uint8_t k, uint32_t now)
{
	struct key_sm *s = &keys[k];

	switch (s->st) {
	case ST_DOWN1:
		stop_timer(k);
		s->st = ST_IDLE;
		if ((now - s->t_down) >= T_SHORT_MAX) {
			return; /* vung mo ho 600-1000 ms */
		}
		if (!is_vol(k) && s->dbl) {
			s->st = ST_WAIT2;
			start_timer(k, T_DOUBLE_GAP);
			return;
		}
		emit(k, G_SHORT);
		return;
	case ST_DOWN2:
		s->st = ST_IDLE;
		emit(k, G_DOUBLE);
		return;
	case ST_SEQ:
		/* Nha truoc 2 s: chi la 1 lan nhan binh thuong (Call giu qua 600 ms: bo qua) */
		stop_timer(k);
		s->st = ST_IDLE;
		if (is_vol(k) || (now - s->t_down) < T_SHORT_MAX) {
			emit(k, G_SHORT);
		}
		return;
	case ST_COMBO: {
		const uint8_t other = (k == KEY_VOL_UP) ? KEY_VOL_DOWN : KEY_VOL_UP;

		if (!combo_fired) {
			combo_gen++;
			k_timer_stop(&combo_timer);
		}
		s->st = ST_IDLE;
		if (keys[other].st == ST_COMBO) {
			keys[other].st = ST_IGNORE;
		}
		return;
	}
	case ST_IGNORE:
	case ST_HELD:
	case ST_HELD2:
	case ST_REPEAT:
		stop_timer(k);
		s->st = ST_IDLE;
		return;
	default:
		return;
	}
}

static void on_timer(uint8_t k, uint32_t gen)
{
	struct key_sm *s;

	if (k == COMBO_TIMER) {
		if (gen == combo_gen && keys[KEY_VOL_UP].st == ST_COMBO &&
		    keys[KEY_VOL_DOWN].st == ST_COMBO && !combo_fired) {
			combo_fired = true;
			emit(KEY_VOL_UP, G_COMBO_VOL);
		}
		return;
	}

	s = &keys[k];
	if (gen != s->gen) {
		return; /* hen gio da bi huy / hen lai */
	}

	switch (s->st) {
	case ST_DOWN1:
		if (is_vol(k)) {
			s->st = ST_REPEAT;
			start_timer(k, T_REPEAT);
			emit(k, G_REPEAT);
		} else {
			s->st = ST_HELD;
			start_timer(k, T_VERY_LONG - T_LONG);
			emit(k, G_LONG);
		}
		break;
	case ST_REPEAT:
		start_timer(k, T_REPEAT);
		emit(k, G_REPEAT);
		break;
	case ST_HELD:
		s->st = ST_HELD2;
		emit(k, G_VERY_LONG);
		break;
	case ST_WAIT2:
		s->st = ST_IDLE;
		emit(k, G_SHORT);
		break;
	case ST_SEQ:
		s->st = ST_HELD2; /* bo qua toi khi nha */
		emit(k, G_SEQ_HOLD);
		break;
	default:
		break;
	}
}

void buttons_init(void)
{
	for (uint8_t k = 0; k < KEY_COUNT; k++) {
		keys[k].st = ST_IDLE;
		k_timer_init(&keys[k].timer, timer_expiry, NULL);
		k_timer_user_data_set(&keys[k].timer, (void *)(uintptr_t)k);
	}
	k_timer_init(&combo_timer, timer_expiry, NULL);
	k_timer_user_data_set(&combo_timer, (void *)(uintptr_t)COMBO_TIMER);
}

void buttons_handle(const struct helmet_evt *evt)
{
	if (evt->type == EVT_KEY_RAW && evt->a < KEY_COUNT) {
		LOG_DBG("Key %s %s", key_names[evt->a], evt->b ? "down" : "up");
		if (evt->b) {
			on_press(evt->a, evt->v);
		} else {
			on_release(evt->a, evt->v);
		}
	} else if (evt->type == EVT_KEY_TIMER && evt->a <= COMBO_TIMER) {
		on_timer(evt->a, evt->v);
	}
}

void buttons_set_double(enum helmet_key key, bool enabled)
{
	if (key < KEY_COUNT) {
		keys[key].dbl = enabled;
	}
}

void buttons_ignore_until_release(enum helmet_key key)
{
	if (key < KEY_COUNT) {
		stop_timer(key);
		keys[key].st = ST_IGNORE;
	}
}

void buttons_arm_seq(uint32_t window_ms)
{
	seq_armed = true;
	seq_until = k_uptime_get_32() + window_ms;
}

const char *buttons_key_str(uint8_t key)
{
	return key < KEY_COUNT ? key_names[key] : "?";
}

const char *buttons_gesture_str(uint8_t gesture)
{
	return gesture < G_COUNT ? gesture_names[gesture] : "?";
}

int buttons_key_from_str(const char *s)
{
	for (int i = 0; i < KEY_COUNT; i++) {
		if (strcmp(key_names[i], s) == 0) {
			return i;
		}
	}
	return -1;
}

int buttons_gesture_from_str(const char *s)
{
	for (int i = 0; i < G_COUNT; i++) {
		if (strcmp(gesture_names[i], s) == 0) {
			return i;
		}
	}
	return -1;
}
```

## src/call_ctrl.c
```c
/*
 * Helmet - dieu khien cuoc goi.
 *
 * - CCP Call Control Client qua TBS client: do GTBS (Generic Telephone Bearer Service) tren
 *   dien thoai, nhan danh sach cuoc goi {index, state, flags} moi khi dien thoai thong bao,
 *   gui lenh nghe / ket thuc. "Tu choi" = ket thuc cuoc goi dang do chuong.
 * - MICP Microphone Device: dien thoai tat/bat micro cua mu; nut tren mu cung di qua
 *   bt_micp_mic_dev_mute/unmute -> mic_mute_cb (mot duong xu ly duy nhat).
 *
 * Callback chay trong thread Bluetooth: chi chep du lieu roi dang su kien len bo dieu khien.
 */

#include <errno.h>

#include <zephyr/kernel.h>
#include <zephyr/bluetooth/audio/micp.h>
#include <zephyr/bluetooth/audio/tbs.h>
#include <zephyr/bluetooth/conn.h>
#include <zephyr/logging/log.h>
#include <zephyr/shell/shell.h>

#include "helmet.h"

LOG_MODULE_REGISTER(call_ctrl, LOG_LEVEL_INF);

#define MAX_CALLS CONFIG_BT_TBS_CLIENT_MAX_CALLS

static struct bt_conn *call_conn;
static bool gtbs_ready;
static struct bt_tbs_client_call_state calls[MAX_CALLS];
static uint8_t call_count;
static enum helmet_call agg = CALL_NONE;
static uint8_t mic_mute = BT_MICP_MUTE_UNMUTED;
static uint8_t last_reason = 0xFF;

static void discover_work_handler(struct k_work *work);
static K_WORK_DEFINE(discover_work, discover_work_handler);

static const char *tbs_state_str(uint8_t state)
{
	switch (state) {
	case BT_TBS_CALL_STATE_INCOMING:
		return "INCOMING";
	case BT_TBS_CALL_STATE_DIALING:
		return "DIALING";
	case BT_TBS_CALL_STATE_ALERTING:
		return "ALERTING";
	case BT_TBS_CALL_STATE_ACTIVE:
		return "ACTIVE";
	case BT_TBS_CALL_STATE_LOCALLY_HELD:
	case BT_TBS_CALL_STATE_REMOTELY_HELD:
	case BT_TBS_CALL_STATE_LOCALLY_AND_REMOTELY_HELD:
		return "HELD";
	default:
		return "?";
	}
}

static const char *reason_str(uint8_t reason)
{
	switch (reason) {
	case BT_TBS_REASON_REMOTE_ENDED_CALL:
		return "remote ended";
	case BT_TBS_REASON_SERVER_ENDED_CALL:
		return "phone ended";
	case BT_TBS_REASON_LINE_BUSY:
		return "line busy";
	case BT_TBS_REASON_NETWORK_CONGESTED:
		return "network congested";
	case BT_TBS_REASON_CLIENT_TERMINATED:
		return "ended by headset";
	case BT_TBS_REASON_NO_SERVICE:
		return "no service";
	case BT_TBS_REASON_NO_ANSWER:
		return "no answer";
	case BT_TBS_REASON_CALL_FAILED:
		return "call failed";
	default:
		return "unspecified";
	}
}

const char *call_ctrl_state_str(enum helmet_call c)
{
	switch (c) {
	case CALL_NONE:
		return "none";
	case CALL_INCOMING:
		return "incoming";
	case CALL_OUTGOING:
		return "outgoing";
	case CALL_ACTIVE:
		return "active";
	case CALL_HELD:
		return "held";
	default:
		return "?";
	}
}

/* Trang thai tong hop, uu tien: INCOMING > ACTIVE > DIALING/ALERTING > HELD > NONE */
static enum helmet_call aggregate(void)
{
	bool active = false;
	bool outgoing = false;
	bool held = false;

	for (uint8_t i = 0; i < call_count; i++) {
		switch (calls[i].state) {
		case BT_TBS_CALL_STATE_INCOMING:
			return CALL_INCOMING;
		case BT_TBS_CALL_STATE_ACTIVE:
			active = true;
			break;
		case BT_TBS_CALL_STATE_DIALING:
		case BT_TBS_CALL_STATE_ALERTING:
			outgoing = true;
			break;
		default:
			held = true;
			break;
		}
	}
	return active ? CALL_ACTIVE : outgoing ? CALL_OUTGOING : held ? CALL_HELD : CALL_NONE;
}

static int find_call(uint8_t s1, uint8_t s2, uint8_t s3, uint8_t *index)
{
	const uint8_t want[3] = {s1, s2, s3};

	for (uint8_t w = 0; w < ARRAY_SIZE(want); w++) {
		for (uint8_t i = 0; i < call_count; i++) {
			if (calls[i].state == want[w]) {
				*index = calls[i].index;
				return 0;
			}
		}
	}
	return -ENOENT;
}

/* ---------------- TBS client callbacks ---------------- */

static void discover_cb(struct bt_conn *conn, int err, uint8_t tbs_count, bool gtbs_found)
{
	if (err || !gtbs_found) {
		LOG_WRN("GTBS not found on phone (err %d) - call control disabled", err);
		gtbs_ready = false;
		return;
	}
	gtbs_ready = true;
	LOG_INF("GTBS found (%u TBS instances) - call control ready", tbs_count);
}

static void call_state_cb(struct bt_conn *conn, int err, uint8_t inst_index, uint8_t count,
			  const struct bt_tbs_client_call_state *states)
{
	enum helmet_call next;

	if (err || inst_index != BT_TBS_GTBS_INDEX) {
		return;
	}

	call_count = MIN(count, MAX_CALLS);
	for (uint8_t i = 0; i < call_count; i++) {
		calls[i] = states[i];
		LOG_INF("Call #%u %s%s", states[i].index, tbs_state_str(states[i].state),
			(states[i].flags & BT_TBS_CALL_FLAG_OUTGOING) ? " (outgoing)" : "");
	}

	next = aggregate();
	if (next != agg) {
		agg = next;
		app_post(EVT_CALL, (uint8_t)agg, 0, 0);
	}
}

static void termination_reason_cb(struct bt_conn *conn, int err, uint8_t inst_index,
				  uint8_t call_index, uint8_t reason)
{
	if (err) {
		return;
	}
	last_reason = reason;
	LOG_INF("Call #%u ended (reason 0x%02x %s)", call_index, reason, reason_str(reason));
}

static void cp_result(const char *what, int err, uint8_t call_index)
{
	if (err) {
		LOG_WRN("%s call #%u failed (%d)", what, call_index, err);
		audio_out_prompt(PROMPT_VOL_LIMIT); /* tieng "tic": lenh khong thanh cong */
	} else {
		LOG_INF("%s call #%u OK", what, call_index);
	}
}

static void accept_cb(struct bt_conn *conn, int err, uint8_t inst_index, uint8_t call_index)
{
	cp_result("Accept", err, call_index);
}

static void terminate_cb(struct bt_conn *conn, int err, uint8_t inst_index, uint8_t call_index)
{
	cp_result("Terminate", err, call_index);
}

#if defined(CONFIG_BT_TBS_CLIENT_INCOMING_CALL)
static void remote_uri_cb(struct bt_conn *conn, int err, uint8_t inst_index, const char *value)
{
	if (!err && value != NULL) {
		LOG_INF("Incoming call from %s", value);
	}
}
#endif

#if defined(CONFIG_BT_TBS_CLIENT_CALL_FRIENDLY_NAME)
static void friendly_name_cb(struct bt_conn *conn, int err, uint8_t inst_index, const char *value)
{
	if (!err && value != NULL) {
		LOG_INF("Caller name: %s", value);
	}
}
#endif

static struct bt_tbs_client_cb tbs_cb = {
	.discover = discover_cb,
	.accept_call = accept_cb,
	.terminate_call = terminate_cb,
	.call_state = call_state_cb,
	.termination_reason = termination_reason_cb,
#if defined(CONFIG_BT_TBS_CLIENT_INCOMING_CALL)
	.remote_uri = remote_uri_cb,
#endif
#if defined(CONFIG_BT_TBS_CLIENT_CALL_FRIENDLY_NAME)
	.friendly_name = friendly_name_cb,
#endif
};

static void discover_work_handler(struct k_work *work)
{
	int err;

	ARG_UNUSED(work);

	if (call_conn == NULL) {
		return;
	}
	err = bt_tbs_client_discover(call_conn);
	if (err) {
		LOG_WRN("GTBS discovery start failed (%d)", err);
	}
}

/* ---------------- MICP Microphone Device ---------------- */

static void mic_mute_cb(uint8_t mute)
{
	if (mute == mic_mute) {
		return;
	}
	mic_mute = mute;
	LOG_INF("Microphone %s", mute == BT_MICP_MUTE_MUTED      ? "MUTED"
				 : mute == BT_MICP_MUTE_DISABLED ? "DISABLED"
								 : "unmuted");
	app_post(EVT_MIC_MUTE, mute == BT_MICP_MUTE_MUTED ? 1 : 0, 0, 0);
}

static struct bt_micp_mic_dev_cb micp_cb = {
	.mute = mic_mute_cb,
};

/* ---------------- API ---------------- */

/* Goi TRUOC bt_enable(): chi them MICS vao co so du lieu GATT (xem main.c) */
int call_ctrl_register(void)
{
	struct bt_micp_mic_dev_register_param micp_param = {
		.cb = &micp_cb,
	};
	int err;

	err = bt_micp_mic_dev_register(&micp_param);
	if (err) {
		LOG_ERR("MICP register failed (%d)", err);
	}
	return err;
}

/* Goi sau bt_enable() + settings_load() */
int call_ctrl_init(void)
{
	int err;

	err = bt_tbs_client_register_cb(&tbs_cb);
	if (err) {
		LOG_ERR("TBS client register failed (%d)", err);
		return err;
	}

	return 0;
}

void call_ctrl_connected(struct bt_conn *conn)
{
	if (call_conn != NULL) {
		return;
	}
	call_conn = bt_conn_ref(conn);
	gtbs_ready = false;
	call_count = 0;
	agg = CALL_NONE;
	k_work_submit(&discover_work);
}

void call_ctrl_disconnected(void)
{
	if (call_conn != NULL) {
		bt_conn_unref(call_conn);
		call_conn = NULL;
	}
	gtbs_ready = false;
	call_count = 0;
	agg = CALL_NONE;
}

static int check_ready(void)
{
	if (call_conn == NULL || !gtbs_ready) {
		LOG_WRN("No call control on phone");
		return -ENOTCONN;
	}
	return 0;
}

int call_ctrl_accept(void)
{
	uint8_t index;
	int err = check_ready();

	if (err) {
		return err;
	}
	if (find_call(BT_TBS_CALL_STATE_INCOMING, BT_TBS_CALL_STATE_INCOMING,
		      BT_TBS_CALL_STATE_INCOMING, &index) != 0) {
		return -ENOENT;
	}
	LOG_INF("Accept call #%u", index);
	return bt_tbs_client_accept_call(call_conn, BT_TBS_GTBS_INDEX, index);
}

int call_ctrl_reject(void)
{
	uint8_t index;
	int err = check_ready();

	if (err) {
		return err;
	}
	if (find_call(BT_TBS_CALL_STATE_INCOMING, BT_TBS_CALL_STATE_INCOMING,
		      BT_TBS_CALL_STATE_INCOMING, &index) != 0) {
		return -ENOENT;
	}
	LOG_INF("Reject call #%u", index);
	return bt_tbs_client_terminate_call(call_conn, BT_TBS_GTBS_INDEX, index);
}

int call_ctrl_hangup(void)
{
	uint8_t index;
	int err = check_ready();

	if (err) {
		return err;
	}
	/* Cuoc dang noi chuyen, neu khong co thi cuoc dang quay so, cuoi cung la cuoc dang giu */
	if (find_call(BT_TBS_CALL_STATE_ACTIVE, BT_TBS_CALL_STATE_ALERTING,
		      BT_TBS_CALL_STATE_DIALING, &index) != 0 &&
	    find_call(BT_TBS_CALL_STATE_LOCALLY_HELD, BT_TBS_CALL_STATE_REMOTELY_HELD,
		      BT_TBS_CALL_STATE_LOCALLY_AND_REMOTELY_HELD, &index) != 0) {
		return -ENOENT;
	}
	LOG_INF("Hang up call #%u", index);
	return bt_tbs_client_terminate_call(call_conn, BT_TBS_GTBS_INDEX, index);
}

int call_ctrl_mic_mute(bool mute)
{
	return mute ? bt_micp_mic_dev_mute() : bt_micp_mic_dev_unmute();
}

void call_ctrl_mic_unavailable(bool unavailable)
{
	if (unavailable) {
		(void)bt_micp_mic_dev_mute_disable();
	} else if (mic_mute == BT_MICP_MUTE_DISABLED) {
		(void)bt_micp_mic_dev_unmute();
	}
}

enum helmet_call call_ctrl_state(void)
{
	return agg;
}

void call_ctrl_print_status(const struct shell *sh)
{
	shell_print(sh, "Calls     : %s, GTBS %s, %u call(s), last end reason %s",
		    call_ctrl_state_str(agg), gtbs_ready ? "ready" : "not available", call_count,
		    last_reason == 0xFF ? "-" : reason_str(last_reason));
	for (uint8_t i = 0; i < call_count; i++) {
		shell_print(sh, "  call #%u : %s%s", calls[i].index, tbs_state_str(calls[i].state),
			    (calls[i].flags & BT_TBS_CALL_FLAG_OUTGOING) ? " (outgoing)" : "");
	}
	shell_print(sh, "Mic mute  : %s", mic_mute == BT_MICP_MUTE_MUTED      ? "muted"
					  : mic_mute == BT_MICP_MUTE_DISABLED ? "disabled"
									      : "unmuted");
}
```

## src/capture.c
```c
/*
 * Helmet - ghi lai luong LE Audio nhan duoc va gui ve PC qua J-Link (SEGGER RTT kenh 1).
 *
 * Moi SDU LC3 nhan tu dien thoai duoc chep nguyen ven (chua giai ma) vao kenh RTT 1,
 * kem cau hinh codec, so thu tu ISO va timestamp. Script scripts/helmet_audio.py tren PC
 * doc kenh nay, giai ma LC3 roi phat ra loa may tinh / luu WAV.
 *
 * - Kenh RTT 0 van danh cho log + shell; kenh 1 chi chua du lieu nhi phan.
 * - Che do NO_BLOCK_SKIP: bo dem day (PC doc khong kip / khong cam J-Link) thi bo ca ban ghi,
 *   khong bao gio lam cham luong nhan. PC thay so thu tu ban ghi nhay coc -> bu bang PLC.
 * - Mac dinh TAT; bat bang "helmet capture on" (script tu gui lenh nay).
 * - Chi co khi build voi EXTRA=-DCONFIG_HELMET_CAPTURE=y (apps/main/Kconfig): bo dem RTT 16 KB RAM,
 *   mac dinh nhuong cho che do Dinh vi (them 1 ket noi + 1 ngu canh CS). Khong build thi cac ham
 *   duoi day la rong va "helmet capture" bao cach bat.
 * - Bang thong lon nhat: 48 kHz stereo, 2 x 155 B / 10 ms ~ 33 KB/s.
 *
 * Dinh dang ban ghi (little-endian):
 *   header 8 B : A5 5A | type u8 | stream u8 | len u16 (do dai payload) | rec_seq u16
 *   CFG  (1)   : freq_hz u32 | frame_dur_us u32 | octets_per_frame u16 | chan_cnt u8 | 0 |
 *                chan_alloc u32
 *   SDU  (2)   : iso_flags u8 (BT_ISO_FLAGS_*) | 0 | iso_seq u16 | ts u32 | LC3 (len - 8 B)
 *   STOP (3)   : khong co payload
 */

#include <string.h>

#include <zephyr/kernel.h>
#include <zephyr/logging/log.h>
#include <zephyr/shell/shell.h>
#include <zephyr/sys/atomic.h>
#include <zephyr/sys/byteorder.h>

#include <SEGGER_RTT.h>

#include "helmet.h"

LOG_MODULE_REGISTER(capture, LOG_LEVEL_INF);

#if defined(CONFIG_HELMET_CAPTURE)

#define CAP_RTT_CHANNEL  1
/* 16 KB ~ 0.5 s o 33 KB/s: J-Link doc cham mot nhip van kip */
#define CAP_RTT_BUF_SIZE CONFIG_HELMET_CAPTURE_BUF
#define CFG_RESEND_SDU   100   /* gui lai cau hinh ~1 s/lan: PC mo giua chung van bat kip */

#define REC_SYNC0   0xA5
#define REC_SYNC1   0x5A
#define REC_HDR_LEN 8
#define REC_CFG_LEN 16
#define REC_SDU_HDR 8

BUILD_ASSERT(CONFIG_SEGGER_RTT_MAX_NUM_UP_BUFFERS > CAP_RTT_CHANNEL,
	     "can them RTT up-buffer cho kenh am thanh");

enum rec_type {
	REC_CFG = 1,
	REC_SDU = 2,
	REC_STOP = 3,
};

struct cap_stream {
	bool active;
	struct helmet_stream_cfg cfg;
	uint32_t sdu_since_cfg;
};

static uint8_t rtt_buf[CAP_RTT_BUF_SIZE];

static atomic_t enabled;
static atomic_t resend_cfg;

/* Cac ham ben duoi co the duoc goi tu nhieu thread Bluetooth -> khoa chung */
K_MUTEX_DEFINE(cap_lock);
static struct cap_stream cs[HELMET_MAX_STREAMS];
static uint8_t rec[REC_HDR_LEN + REC_SDU_HDR + HELMET_MAX_SDU_LEN];
static uint16_t rec_seq;
static uint32_t rec_sent;
static uint32_t rec_dropped;

static void send_rec(uint8_t type, uint8_t idx, uint16_t len)
{
	rec[0] = REC_SYNC0;
	rec[1] = REC_SYNC1;
	rec[2] = type;
	rec[3] = idx;
	sys_put_le16(len, &rec[4]);
	sys_put_le16(rec_seq++, &rec[6]);

	/* SKIP: hoac ghi tron ca ban ghi, hoac khong ghi gi (tra ve 0) */
	if (SEGGER_RTT_Write(CAP_RTT_CHANNEL, rec, REC_HDR_LEN + len) == 0) {
		rec_dropped++;
	} else {
		rec_sent++;
	}
}

static void send_cfg(uint8_t idx)
{
	const struct helmet_stream_cfg *cfg = &cs[idx].cfg;
	uint8_t *p = &rec[REC_HDR_LEN];

	sys_put_le32(cfg->freq_hz, &p[0]);
	sys_put_le32(cfg->frame_dur_us, &p[4]);
	sys_put_le16(cfg->octets_per_frame, &p[8]);
	p[10] = cfg->chan_cnt;
	p[11] = 0;
	sys_put_le32(cfg->chan_alloc, &p[12]);

	send_rec(REC_CFG, idx, REC_CFG_LEN);
	cs[idx].sdu_since_cfg = 0;
}

int capture_init(void)
{
	int err = SEGGER_RTT_ConfigUpBuffer(CAP_RTT_CHANNEL, "HelmetAudio", rtt_buf,
					    sizeof(rtt_buf), SEGGER_RTT_MODE_NO_BLOCK_SKIP);

	if (err < 0) {
		LOG_ERR("RTT channel %u config failed (%d)", CAP_RTT_CHANNEL, err);
		return -EIO;
	}
	return 0;
}

void capture_set_enabled(bool on)
{
	if (on) {
		atomic_set(&resend_cfg, 1);
	}
	atomic_set(&enabled, on ? 1 : 0);
	LOG_INF("Audio capture %s (RTT channel %u)", on ? "ON" : "OFF", CAP_RTT_CHANNEL);
}

void capture_stream_start(uint8_t idx, const struct helmet_stream_cfg *cfg)
{
	if (idx >= ARRAY_SIZE(cs)) {
		return;
	}

	k_mutex_lock(&cap_lock, K_FOREVER);
	cs[idx].cfg = *cfg;
	cs[idx].active = true;
	if (atomic_get(&enabled)) {
		send_cfg(idx);
	}
	k_mutex_unlock(&cap_lock);
}

void capture_stream_stop(uint8_t idx)
{
	if (idx >= ARRAY_SIZE(cs)) {
		return;
	}

	k_mutex_lock(&cap_lock, K_FOREVER);
	if (cs[idx].active) {
		cs[idx].active = false;
		if (atomic_get(&enabled)) {
			send_rec(REC_STOP, idx, 0);
		}
	}
	k_mutex_unlock(&cap_lock);
}

void capture_sdu(uint8_t idx, uint8_t iso_flags, uint16_t iso_seq, uint32_t ts,
		 const uint8_t *data, uint16_t len)
{
	uint8_t *p = &rec[REC_HDR_LEN];

	if (!atomic_get(&enabled) || idx >= ARRAY_SIZE(cs)) {
		return;
	}
	if (len > HELMET_MAX_SDU_LEN) {
		len = 0;
	}

	k_mutex_lock(&cap_lock, K_FOREVER);
	if (!cs[idx].active) {
		k_mutex_unlock(&cap_lock);
		return;
	}

	if (atomic_clear(&resend_cfg)) {
		for (uint8_t i = 0; i < ARRAY_SIZE(cs); i++) {
			if (cs[i].active) {
				send_cfg(i);
			}
		}
	} else if (cs[idx].sdu_since_cfg >= CFG_RESEND_SDU) {
		send_cfg(idx);
	}

	p[0] = iso_flags;
	p[1] = 0;
	sys_put_le16(iso_seq, &p[2]);
	sys_put_le32(ts, &p[4]);
	if (len > 0) {
		memcpy(&p[REC_SDU_HDR], data, len);
	}
	send_rec(REC_SDU, idx, REC_SDU_HDR + len);
	cs[idx].sdu_since_cfg++;
	k_mutex_unlock(&cap_lock);
}

void capture_print_status(const struct shell *sh)
{
	shell_print(sh, "Capture   : %s, RTT channel %u, records sent %u, dropped %u (buffer full), "
		    "%u B waiting",
		    atomic_get(&enabled) ? "ON" : "off", CAP_RTT_CHANNEL, rec_sent, rec_dropped,
		    SEGGER_RTT_GetBytesInBuffer(CAP_RTT_CHANNEL));
}

#else /* !CONFIG_HELMET_CAPTURE: khong build */

int capture_init(void)
{
	return -ENOTSUP;
}

void capture_set_enabled(bool on)
{
	if (on) {
		LOG_WRN("Audio capture not built in - rebuild with EXTRA=-DCONFIG_HELMET_CAPTURE=y "
			"(uses 16 KB RAM)");
	}
}

void capture_stream_start(uint8_t idx, const struct helmet_stream_cfg *cfg)
{
	ARG_UNUSED(idx);
	ARG_UNUSED(cfg);
}

void capture_stream_stop(uint8_t idx)
{
	ARG_UNUSED(idx);
}

void capture_sdu(uint8_t idx, uint8_t iso_flags, uint16_t iso_seq, uint32_t ts,
		 const uint8_t *data, uint16_t len)
{
	ARG_UNUSED(idx);
	ARG_UNUSED(iso_flags);
	ARG_UNUSED(iso_seq);
	ARG_UNUSED(ts);
	ARG_UNUSED(data);
	ARG_UNUSED(len);
}

void capture_print_status(const struct shell *sh)
{
	shell_print(sh, "Capture   : not built in (make APP=apps/main "
		    "EXTRA=-DCONFIG_HELMET_CAPTURE=y build; uses 16 KB RAM)");
}

#endif /* CONFIG_HELMET_CAPTURE */
```

## src/gatt_trace.c
```c
/*
 * Helmet - CHAN DOAN (tam thoi): ghi log moi lan thiet bi kia doc / ghi mot thuoc tinh GATT
 * cua mu. Dung de xem dien thoai lam gi voi PACS / BASS / ASCS khi "chia se am thanh".
 *
 * CONFIG_BT_GATT_AUTHORIZATION_CUSTOM: Zephyr hoi ung dung truoc moi lenh ATT Read / Write
 * (att.c, sau khi da kiem tra quyen + ma hoa). Module nay luon cho phep, chi ghi log.
 * Bo qua khai bao dich vu / dac tinh (doc khi do tim). Moi lenh GHI deu duoc ghi log; lenh DOC
 * lap lai cung handle trong 200 ms (Read Blob cua mot gia tri dai) chi ghi mot lan.
 * Bat / tat: "helmet trace [on|off]" (mac dinh bat).
 * Callback chay trong bt_rx.
 */

#include <errno.h>
#include <string.h>

#include <zephyr/kernel.h>
#include <zephyr/bluetooth/conn.h>
#include <zephyr/bluetooth/gatt.h>
#include <zephyr/bluetooth/uuid.h>
#include <zephyr/logging/log.h>
#include <zephyr/shell/shell.h>
#include <zephyr/sys/atomic.h>
#include <zephyr/sys/util.h>

#include "helmet.h"

LOG_MODULE_REGISTER(gatt_trace, LOG_LEVEL_INF);

struct uuid_name {
	uint16_t uuid;
	const char *name;
};

static const struct uuid_name names[] = {
	{BT_UUID_GAP_DEVICE_NAME_VAL, "GAP Device Name"},
	{BT_UUID_GAP_APPEARANCE_VAL, "GAP Appearance"},
	{BT_UUID_GAP_PPCP_VAL, "GAP Preferred Conn Params"},
	{BT_UUID_CENTRAL_ADDR_RES_VAL, "GAP Central Address Resolution"},
	{BT_UUID_GATT_SC_VAL, "GATT Service Changed"},
	{BT_UUID_GATT_CLIENT_FEATURES_VAL, "GATT Client Supported Features"},
	{BT_UUID_GATT_DB_HASH_VAL, "GATT Database Hash"},
	{BT_UUID_GATT_SERVER_FEATURES_VAL, "GATT Server Supported Features"},
	{BT_UUID_BASS_CONTROL_POINT_VAL, "BASS Control Point"},
	{BT_UUID_BASS_RECV_STATE_VAL, "BASS Receive State"},
	{BT_UUID_PACS_SNK_VAL, "PACS Sink PAC"},
	{BT_UUID_PACS_SNK_LOC_VAL, "PACS Sink Audio Locations"},
	{BT_UUID_PACS_SRC_VAL, "PACS Source PAC"},
	{BT_UUID_PACS_SRC_LOC_VAL, "PACS Source Audio Locations"},
	{BT_UUID_PACS_AVAILABLE_CONTEXT_VAL, "PACS Available Contexts"},
	{BT_UUID_PACS_SUPPORTED_CONTEXT_VAL, "PACS Supported Contexts"},
	{BT_UUID_ASCS_ASE_SNK_VAL, "ASCS Sink ASE"},
	{BT_UUID_ASCS_ASE_SRC_VAL, "ASCS Source ASE"},
	{BT_UUID_ASCS_ASE_CP_VAL, "ASCS ASE Control Point"},
	{BT_UUID_VCS_STATE_VAL, "VCS Volume State"},
	{BT_UUID_VCS_CONTROL_VAL, "VCS Control Point"},
	{BT_UUID_VCS_FLAGS_VAL, "VCS Volume Flags"},
	{BT_UUID_MICS_MUTE_VAL, "MICS Mute"},
	{BT_UUID_GATT_TMAPR_VAL, "TMAS Role"},
	{BT_UUID_HTS_MEASUREMENT_VAL, "HTS Temperature"},
	{BT_UUID_HTS_TEMP_TYP_VAL, "HTS Temperature Type"},
	{BT_UUID_HTS_TEMP_INT_VAL, "HTS Intermediate Temperature"},
	{BT_UUID_HTS_INTERVAL_VAL, "HTS Measurement Interval"},
	{BT_UUID_GATT_CUD_VAL, "User Description"},
};

static atomic_t enabled = ATOMIC_INIT(1);

/* Chi bt_rx dung: bo qua Read Blob lien tiep cua cung mot thuoc tinh */
#define READ_DEDUP_MS 200
static uint16_t last_handle;
static uint8_t last_conn = 0xff;
static int64_t last_read_ms;

static const char *uuid_name(const struct bt_uuid *uuid, char *buf, size_t len)
{
	if (uuid->type == BT_UUID_TYPE_16) {
		const uint16_t v = BT_UUID_16(uuid)->val;

		for (size_t i = 0; i < ARRAY_SIZE(names); i++) {
			if (names[i].uuid == v) {
				return names[i].name;
			}
		}
	}
	bt_uuid_to_str(uuid, buf, len);
	return buf;
}

static uint8_t find_attr_cb(const struct bt_gatt_attr *attr, uint16_t handle, void *user_data)
{
	const struct bt_gatt_attr **out = user_data;

	ARG_UNUSED(handle);
	*out = attr;
	return BT_GATT_ITER_STOP;
}

static void trace(struct bt_conn *conn, const struct bt_gatt_attr *attr, bool write)
{
	const uint16_t handle = bt_gatt_attr_get_handle(attr);
	const uint8_t ci = bt_conn_index(conn);
	char buf[BT_UUID_STR_LEN];
	char pbuf[BT_UUID_STR_LEN];

	if (!atomic_get(&enabled)) {
		return;
	}
	/* Khai bao dich vu / dac tinh: dien thoai dang do tim, khong phai doc gia tri */
	if (!bt_uuid_cmp(attr->uuid, BT_UUID_GATT_CHRC) ||
	    !bt_uuid_cmp(attr->uuid, BT_UUID_GATT_PRIMARY) ||
	    !bt_uuid_cmp(attr->uuid, BT_UUID_GATT_SECONDARY) ||
	    !bt_uuid_cmp(attr->uuid, BT_UUID_GATT_INCLUDE)) {
		return;
	}
	if (!write) {
		const int64_t now = k_uptime_get();

		if (handle == last_handle && ci == last_conn && now - last_read_ms < READ_DEDUP_MS) {
			return;
		}
		last_handle = handle;
		last_conn = ci;
		last_read_ms = now;
	} else {
		last_handle = 0;
	}

	if (!bt_uuid_cmp(attr->uuid, BT_UUID_GATT_CCC)) {
		/* CCC dung ngay sau gia tri cua dac tinh no thuoc ve */
		const struct bt_gatt_attr *parent = NULL;

		if (handle > 1) {
			bt_gatt_foreach_attr(handle - 1, handle - 1, find_attr_cb, &parent);
		}
		LOG_INF("conn %u %s h0x%04x CCC of %s", ci, write ? "WRITE" : "read ", handle,
			parent ? uuid_name(parent->uuid, pbuf, sizeof(pbuf)) : "?");
		return;
	}

	LOG_INF("conn %u %s h0x%04x %s", ci, write ? "WRITE" : "read ", handle,
		uuid_name(attr->uuid, buf, sizeof(buf)));
}

static bool read_authorize(struct bt_conn *conn, const struct bt_gatt_attr *attr)
{
	trace(conn, attr, false);
	return true;
}

static bool write_authorize(struct bt_conn *conn, const struct bt_gatt_attr *attr)
{
	trace(conn, attr, true);
	return true;
}

static const struct bt_gatt_authorization_cb auth_cb = {
	.read_authorize = read_authorize,
	.write_authorize = write_authorize,
};

/* ATT MTU: Receive State / PAC dai hon MTU - 3 thi dien thoai phai doc dai */
static void mtu_updated(struct bt_conn *conn, uint16_t tx, uint16_t rx)
{
	LOG_INF("conn %u ATT MTU: tx %u, rx %u", bt_conn_index(conn), tx, rx);
}

static struct bt_gatt_cb gatt_cb = {
	.att_mtu_updated = mtu_updated,
};

int gatt_trace_init(void)
{
	int err = bt_gatt_authorization_cb_register(&auth_cb);

	if (err) {
		LOG_ERR("GATT trace register failed (%d)", err);
		return err;
	}
	bt_gatt_cb_register(&gatt_cb);
	LOG_INF("GATT access trace ON (diagnostic build) - \"helmet trace off\" to silence");
	return 0;
}

int gatt_trace_shell(const struct shell *sh, size_t argc, char **argv)
{
	if (argc > 1) {
		if (strcmp(argv[1], "on") == 0) {
			atomic_set(&enabled, 1);
			last_handle = 0;
		} else if (strcmp(argv[1], "off") == 0) {
			atomic_set(&enabled, 0);
		} else {
			shell_error(sh, "usage: helmet trace [on|off]");
			return -EINVAL;
		}
	}
	shell_print(sh, "GATT access trace %s", atomic_get(&enabled) ? "ON" : "OFF");
	return 0;
}
```
