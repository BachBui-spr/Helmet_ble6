## CMakeLists.txt
```
cmake_minimum_required(VERSION 3.20.0)

find_package(Zephyr REQUIRED HINTS $ENV{ZEPHYR_BASE})
project(helmet)

target_sources(app PRIVATE
  src/main.c
  src/le_audio.c
  src/media_ctrl.c
  src/audio_out.c
  src/capture.c
)
```

## prj.conf
```kconfig
# ============================================================
#  Helmet - tai nghe LE Audio (nRF54L15 khong co Bluetooth Classic/A2DP)
#  CAP Acceptor + BAP Unicast Server + TMAP UMR + VCP + MCP client
# ============================================================

# ---- Log + shell qua SEGGER RTT (make rtt) va UART20 ----
CONFIG_LOG=y
CONFIG_LOG_MODE_DEFERRED=y
CONFIG_LOG_BUFFER_SIZE=4096
CONFIG_USE_SEGGER_RTT=y
CONFIG_SEGGER_RTT_BUFFER_SIZE_UP=4096
CONFIG_SEGGER_RTT_BUFFER_SIZE_DOWN=256
CONFIG_SHELL=y
CONFIG_SHELL_BACKEND_SERIAL=y
CONFIG_SHELL_BACKEND_RTT=y
CONFIG_SHELL_STACK_SIZE=3072
CONFIG_KERNEL_SHELL=y
CONFIG_THREAD_NAME=y
CONFIG_THREAD_MONITOR=y

# ---- Bluetooth LE co ban ----
CONFIG_BT=y
CONFIG_BT_PERIPHERAL=y
CONFIG_BT_DEVICE_NAME="Helmet"
CONFIG_BT_EXT_ADV=y
CONFIG_BT_HCI_ERR_TO_STR=y
# Bao PHY cua lien ket (chan doan song: heartbeat "link:" + log khi PHY doi)
CONFIG_BT_USER_PHY_UPDATE=y
# Thong so ket noi uu tien cho LE Audio (theo mau tmap_peripheral)
CONFIG_BT_GAP_AUTO_UPDATE_CONN_PARAMS=n
CONFIG_BT_PERIPHERAL_PREF_MIN_INT=50
CONFIG_BT_PERIPHERAL_PREF_MAX_INT=70
CONFIG_BT_PERIPHERAL_PREF_LATENCY=0
CONFIG_BT_PERIPHERAL_PREF_TIMEOUT=400

# ---- Bao mat + luu bond vao RRAM (phan vung storage, ZMS) ----
CONFIG_BT_SMP=y
CONFIG_BT_PRIVACY=y
CONFIG_BT_MAX_PAIRED=4
CONFIG_BT_KEYS_OVERWRITE_OLDEST=y
CONFIG_BT_SETTINGS=y
CONFIG_SETTINGS=y
CONFIG_FLASH=y
CONFIG_FLASH_MAP=y
CONFIG_ZMS=y

# ---- GATT (client can cho MCP, dynamic DB cho dich vu LE Audio) ----
CONFIG_BT_GATT_CLIENT=y
CONFIG_BT_GATT_AUTO_DISCOVER_CCC=y
CONFIG_BT_GATT_DYNAMIC_DB=y
CONFIG_BT_ATT_PREPARE_COUNT=1
CONFIG_BT_ATT_TX_COUNT=20
CONFIG_UTF8=y

# ---- LE Audio ----
CONFIG_BT_AUDIO=y
CONFIG_BT_ISO_PERIPHERAL=y
CONFIG_BT_ISO_MAX_CHAN=2
# Helmet chi NHAN ISO (khong gui) -> 1 bo dem ISO TX trong controller, khop voi host
CONFIG_BT_CTLR_SDC_ISO_TX_HCI_BUFFER_COUNT=1
CONFIG_BT_BAP_UNICAST_SERVER=y
CONFIG_BT_ASCS=y
CONFIG_BT_ASCS_MAX_ASE_SNK_COUNT=2
CONFIG_BT_ASCS_MAX_ASE_SRC_COUNT=0
CONFIG_BT_PAC_SNK=y
CONFIG_BT_PAC_SNK_LOC=y
CONFIG_BT_PAC_SRC=n
CONFIG_BT_CAP_ACCEPTOR=y
CONFIG_BT_TMAP=y
CONFIG_BT_VCP_VOL_REND=y
CONFIG_BT_MCC=y

# ---- Giai ma LC3 (liblc3, dung FPU cua Cortex-M33) + I2S ----
CONFIG_FPU=y
CONFIG_FPU_SHARING=y
CONFIG_LIBLC3=y
CONFIG_I2S=y

# ---- Nut nhan (gpio-keys -> input) ----
CONFIG_INPUT=y

# ---- Stack ----
CONFIG_MAIN_STACK_SIZE=2048
CONFIG_SYSTEM_WORKQUEUE_STACK_SIZE=2048
```

## src/main.c
```c
/*
 * Helmet - chuong trinh chinh: mu bao hiem nghe nhac qua Bluetooth LE Audio.
 *
 * nRF54L15 chi co Bluetooth LE, KHONG co Bluetooth Classic, nen khong the dung A2DP.
 * Nhac duoc truyen bang LE Audio: dien thoai ho tro LE Audio ket noi toi Helmet,
 * gui luong LC3 qua kenh dang thoi (CIS); Helmet giai ma va phat ra 2 loa qua I2S.
 *
 * Vai tro Bluetooth cua Helmet:
 *   - CAP Acceptor + BAP Unicast Server (nhan am thanh)
 *   - TMAP Unicast Media Receiver (UMR)
 *   - VCP Volume Renderer (dien thoai va nut tren mu cung chinh am luong)
 *   - MCP client (nut Call -> play/pause tren dien thoai)
 *
 * Nut (board nut): Vol+ / Vol- : am luong, Call: play/pause, Power: (du phong)
 * Log + shell qua RTT (make rtt) va UART20. Lenh: "helmet status|vol|play|pause|unpair".
 */

#include <stdlib.h>
#include <string.h>

#include <zephyr/kernel.h>
#include <zephyr/bluetooth/audio/audio.h>
#include <zephyr/bluetooth/audio/bap.h>
#include <zephyr/bluetooth/audio/tmap.h>
#include <zephyr/bluetooth/bluetooth.h>
#include <zephyr/bluetooth/conn.h>
#include <zephyr/bluetooth/gap.h>
#include <zephyr/bluetooth/hci.h>
#include <zephyr/bluetooth/uuid.h>
#include <zephyr/input/input.h>
#include <zephyr/logging/log.h>
#include <zephyr/net_buf.h>
#include <zephyr/settings/settings.h>
#include <zephyr/shell/shell.h>
#include <zephyr/sys/byteorder.h>

#include "helmet.h"

LOG_MODULE_REGISTER(helmet, LOG_LEVEL_INF);

#define HEARTBEAT_PERIOD_S 10

static struct bt_le_ext_adv *adv;
static struct bt_conn *active_conn;
static bt_security_t sec_level;

static void adv_work_handler(struct k_work *work);
static K_WORK_DEFINE(adv_work, adv_work_handler);

/* ---------------- Quang ba LE Audio ---------------- */

/* ASCS: "san sang nhan am thanh" cho cac ngu canh HELMET_SINK_CONTEXTS */
static const uint8_t ascs_addata[] = {
	BT_UUID_16_ENCODE(BT_UUID_ASCS_VAL),
	BT_AUDIO_UNICAST_ANNOUNCEMENT_GENERAL,
	BT_BYTES_LIST_LE16(HELMET_SINK_CONTEXTS),
	BT_BYTES_LIST_LE16(0x0000), /* khong co nguon am thanh (chua dung micro) */
	0x00,                       /* metadata length */
};

static const uint8_t cas_addata[] = {
	BT_UUID_16_ENCODE(BT_UUID_CAS_VAL),
	BT_AUDIO_UNICAST_ANNOUNCEMENT_GENERAL,
};

static const uint8_t tmas_addata[] = {
	BT_UUID_16_ENCODE(BT_UUID_TMAS_VAL),
	BT_BYTES_LIST_LE16(BT_TMAP_ROLE_UMR),
};

static const struct bt_data ad[] = {
	BT_DATA_BYTES(BT_DATA_FLAGS, (BT_LE_AD_GENERAL | BT_LE_AD_NO_BREDR)),
	BT_DATA_BYTES(BT_DATA_GAP_APPEARANCE,
		      BT_BYTES_LIST_LE16(BT_APPEARANCE_WEARABLE_AUDIO_DEVICE_HEADSET)),
	BT_DATA_BYTES(BT_DATA_UUID16_SOME, BT_UUID_16_ENCODE(BT_UUID_ASCS_VAL),
		      BT_UUID_16_ENCODE(BT_UUID_CAS_VAL), BT_UUID_16_ENCODE(BT_UUID_TMAS_VAL)),
	BT_DATA(BT_DATA_SVC_DATA16, tmas_addata, ARRAY_SIZE(tmas_addata)),
	BT_DATA(BT_DATA_SVC_DATA16, cas_addata, ARRAY_SIZE(cas_addata)),
	BT_DATA(BT_DATA_SVC_DATA16, ascs_addata, ARRAY_SIZE(ascs_addata)),
	BT_DATA(BT_DATA_NAME_COMPLETE, CONFIG_BT_DEVICE_NAME, sizeof(CONFIG_BT_DEVICE_NAME) - 1),
};

static void adv_work_handler(struct k_work *work)
{
	int err;

	ARG_UNUSED(work);

	if (active_conn != NULL || adv == NULL) {
		return;
	}

	err = bt_le_ext_adv_start(adv, BT_LE_EXT_ADV_START_DEFAULT);
	if (err && err != -EALREADY) {
		LOG_ERR("Advertising start failed (%d)", err);
		return;
	}
	LOG_INF("Advertising as \"%s\" (LE Audio headset)", CONFIG_BT_DEVICE_NAME);
}

static int advertising_create(void)
{
	int err;

	err = bt_le_ext_adv_create(BT_BAP_ADV_PARAM_CONN_QUICK, NULL, &adv);
	if (err) {
		LOG_ERR("Advertising set create failed (%d)", err);
		return err;
	}

	err = bt_le_ext_adv_set_data(adv, ad, ARRAY_SIZE(ad), NULL, 0);
	if (err) {
		LOG_ERR("Advertising data failed (%d)", err);
		return err;
	}

	return 0;
}

/* ---------------- Ket noi / bao mat ---------------- */

static void connected(struct bt_conn *conn, uint8_t err)
{
	char addr[BT_ADDR_LE_STR_LEN];

	bt_addr_le_to_str(bt_conn_get_dst(conn), addr, sizeof(addr));
	if (err) {
		LOG_WRN("Connection to %s failed (0x%02x %s)", addr, err, bt_hci_err_to_str(err));
		return;
	}

	if (active_conn == NULL) {
		active_conn = bt_conn_ref(conn);
	}
	sec_level = BT_SECURITY_L1;
	LOG_INF("Connected: %s", addr);

	/* LE Audio yeu cau lien ket ma hoa: chu dong de nghi ghep doi/ma hoa */
	err = bt_conn_set_security(conn, BT_SECURITY_L2);
	if (err) {
		LOG_WRN("Security request failed (%d)", err);
	}
}

static void disconnected(struct bt_conn *conn, uint8_t reason)
{
	char addr[BT_ADDR_LE_STR_LEN];

	bt_addr_le_to_str(bt_conn_get_dst(conn), addr, sizeof(addr));
	LOG_INF("Disconnected: %s (reason 0x%02x %s)", addr, reason, bt_hci_err_to_str(reason));

	if (conn == active_conn) {
		bt_conn_unref(active_conn);
		active_conn = NULL;
		media_ctrl_disconnected();
	}
}

static void recycled(void)
{
	k_work_submit(&adv_work);
}

static void security_changed(struct bt_conn *conn, bt_security_t level, enum bt_security_err err)
{
	if (err) {
		LOG_WRN("Security failed: level %d, err %d %s", level, err,
			bt_security_err_to_str(err));
		return;
	}

	sec_level = level;
	LOG_INF("Link encrypted (security level %d)", level);
	media_ctrl_connected(conn);
}

static void le_phy_updated(struct bt_conn *conn, struct bt_conn_le_phy_info *param)
{
	ARG_UNUSED(conn);
	LOG_INF("ACL PHY: tx %s, rx %s", le_audio_phy_str(param->tx_phy),
		le_audio_phy_str(param->rx_phy));
}

static void le_param_updated(struct bt_conn *conn, uint16_t interval, uint16_t latency,
			     uint16_t timeout)
{
	ARG_UNUSED(conn);
	LOG_INF("ACL params: interval %u us, latency %u, timeout %u ms", interval * 1250U, latency,
		timeout * 10U);
}

BT_CONN_CB_DEFINE(conn_callbacks) = {
	.connected = connected,
	.disconnected = disconnected,
	.recycled = recycled,
	.security_changed = security_changed,
	.le_phy_updated = le_phy_updated,
	.le_param_updated = le_param_updated,
};

/* ---------------- Chan doan lien ket (PHY, chu ky ACL, co ISO) ---------------- */

static void log_link(void)
{
	struct bt_conn *conn = active_conn ? bt_conn_ref(active_conn) : NULL;
	struct helmet_rx_flags rx;
	struct bt_conn_info info;
	const char *tx_phy = "?";
	const char *rx_phy = "?";
	uint32_t interval_us = 0;

	if (conn == NULL) {
		return;
	}

	if (bt_conn_get_info(conn, &info) == 0) {
		interval_us = info.le.interval_us;
		if (info.le.phy != NULL) {
			tx_phy = le_audio_phy_str(info.le.phy->tx_phy);
			rx_phy = le_audio_phy_str(info.le.phy->rx_phy);
		}
	}
	bt_conn_unref(conn);

	/* SDC khong ho tro HCI Read RSSI -> chi bao PHY + chu ky ACL */
	le_audio_get_rx_flags(&rx);
	LOG_INF("link: ACL interval %u us, PHY tx %s / rx %s; ISO rx ok %u, CRC %u, lost %u, "
		"empty %u",
		interval_us, tx_phy, rx_phy, rx.ok, rx.crc, rx.lost, rx.empty);
	le_audio_print_link_quality(NULL);
}

static void pairing_complete(struct bt_conn *conn, bool bonded)
{
	ARG_UNUSED(conn);
	LOG_INF("Pairing complete (%s)", bonded ? "bonded, keys saved" : "not bonded");
}

static void pairing_failed(struct bt_conn *conn, enum bt_security_err reason)
{
	ARG_UNUSED(conn);
	LOG_WRN("Pairing failed: %d %s - xoa thiet bi tren dien thoai roi ghep lai", reason,
		bt_security_err_to_str(reason));
}

static struct bt_conn_auth_info_cb auth_info_cb = {
	.pairing_complete = pairing_complete,
	.pairing_failed = pairing_failed,
};

/* ---------------- Nut nhan ---------------- */

static void on_input(struct input_event *evt, void *user_data)
{
	int err = 0;

	ARG_UNUSED(user_data);

	if (evt->type != INPUT_EV_KEY || evt->value == 0) {
		return; /* chi xu ly luc nhan xuong */
	}

	switch (evt->code) {
	case INPUT_KEY_VOLUMEUP:
		LOG_INF("Button Vol+");
		err = media_ctrl_volume_up();
		break;
	case INPUT_KEY_VOLUMEDOWN:
		LOG_INF("Button Vol-");
		err = media_ctrl_volume_down();
		break;
	case INPUT_KEY_PLAYPAUSE:
		LOG_INF("Button Call -> play/pause");
		err = media_ctrl_play_pause();
		break;
	case INPUT_KEY_POWER:
		LOG_INF("Button Power (chua gan chuc nang)");
		break;
	default:
		break;
	}

	if (err) {
		LOG_WRN("Button action failed (%d)", err);
	}
}

INPUT_CALLBACK_DEFINE(NULL, on_input, NULL);

/* ---------------- Shell ---------------- */

static int cmd_status(const struct shell *sh, size_t argc, char **argv)
{
	char addr[BT_ADDR_LE_STR_LEN] = "-";

	ARG_UNUSED(argc);
	ARG_UNUSED(argv);

	if (active_conn != NULL) {
		bt_addr_le_to_str(bt_conn_get_dst(active_conn), addr, sizeof(addr));
	}
	shell_print(sh, "Connection: %s%s (security %d)", addr,
		    active_conn ? "" : " (advertising)", active_conn ? sec_level : 0);
	media_ctrl_print_status(sh);
	le_audio_print_status(sh);
	return 0;
}

static int cmd_vol(const struct shell *sh, size_t argc, char **argv)
{
	long v = strtol(argv[1], NULL, 10);

	if (v < 0 || v > 255) {
		shell_error(sh, "usage: helmet vol <0..255>");
		return -EINVAL;
	}
	return media_ctrl_set_volume((uint8_t)v);
}

static int cmd_play(const struct shell *sh, size_t argc, char **argv)
{
	ARG_UNUSED(sh);
	ARG_UNUSED(argc);
	ARG_UNUSED(argv);
	return media_ctrl_play();
}

static int cmd_pause(const struct shell *sh, size_t argc, char **argv)
{
	ARG_UNUSED(sh);
	ARG_UNUSED(argc);
	ARG_UNUSED(argv);
	return media_ctrl_pause();
}

static int cmd_unpair(const struct shell *sh, size_t argc, char **argv)
{
	int err;

	ARG_UNUSED(argc);
	ARG_UNUSED(argv);

	err = bt_unpair(BT_ID_DEFAULT, BT_ADDR_LE_ANY);
	if (err) {
		shell_error(sh, "unpair failed (%d)", err);
		return err;
	}
	shell_print(sh, "All bonds deleted - xoa ca \"%s\" tren dien thoai truoc khi ghep lai",
		    CONFIG_BT_DEVICE_NAME);
	return 0;
}

static int cmd_capture(const struct shell *sh, size_t argc, char **argv)
{
	if (argc > 1) {
		if (strcmp(argv[1], "on") == 0) {
			capture_set_enabled(true);
		} else if (strcmp(argv[1], "off") == 0) {
			capture_set_enabled(false);
		} else {
			shell_error(sh, "usage: helmet capture [on|off]");
			return -EINVAL;
		}
	}
	capture_print_status(sh);
	return 0;
}

static int parse_phy(const char *s, uint8_t *phy)
{
	if (strcmp(s, "1m") == 0) {
		*phy = BT_GAP_LE_PHY_1M;
	} else if (strcmp(s, "2m") == 0) {
		*phy = BT_GAP_LE_PHY_2M;
	} else if (strcmp(s, "coded") == 0) {
		*phy = BT_GAP_LE_PHY_CODED;
	} else {
		return -EINVAL;
	}
	return 0;
}

/* Thu nghiem: doi PHY cua lien ket ACL (kiem tra Helmet nhan 2M co tot khong) */
static int cmd_aclphy(const struct shell *sh, size_t argc, char **argv)
{
	struct bt_conn_le_phy_param param = {.options = BT_CONN_LE_PHY_OPT_NONE};
	uint8_t phy;
	int err;

	if (parse_phy(argv[1], &phy) != 0) {
		shell_error(sh, "usage: helmet aclphy <1m|2m|coded>");
		return -EINVAL;
	}
	if (active_conn == NULL) {
		shell_error(sh, "not connected");
		return -ENOTCONN;
	}

	param.pref_tx_phy = phy;
	param.pref_rx_phy = phy;
	err = bt_conn_le_phy_update(active_conn, &param);
	if (err) {
		shell_error(sh, "PHY update failed (%d)", err);
	}
	return err;
}

/* Thu nghiem: xin doi chu ky ACL. Controller Zephyr (ll_sw) lam central co the tinh sai
 * CIS offset khi chu ky ACL khac chu ky ISO -> dat ACL = ISO interval (10 ms) roi tao lai luong.
 */
static int cmd_aclint(const struct shell *sh, size_t argc, char **argv)
{
	long ms = strtol(argv[1], NULL, 10);
	struct bt_le_conn_param param;
	uint16_t units;
	int err;

	/* Don vi 1.25 ms: chi nhan so ms chia het cho 5 (10, 15, 20, ...) */
	if (ms < 10 || ms > 4000 || (ms * 4) % 5 != 0) {
		shell_error(sh, "usage: helmet aclint <ms>  (10, 15, 20, ..., boi so cua 5)");
		return -EINVAL;
	}
	if (active_conn == NULL) {
		shell_error(sh, "not connected");
		return -ENOTCONN;
	}

	units = (uint16_t)((ms * 4) / 5);
	param = (struct bt_le_conn_param)BT_LE_CONN_PARAM_INIT(units, units, 0, 400);
	err = bt_conn_le_param_update(active_conn, &param);
	if (err) {
		shell_error(sh, "param update failed (%d)", err);
	} else {
		shell_print(sh, "Requested ACL interval %ld ms - dung roi phat lai nhac de tao lai CIS",
			    ms);
	}
	return err;
}

/* Thu nghiem: QoS Helmet de nghi cho CIS (PHY, so lan phat lai, do tre). Thiet bi phat
 * co the khong theo; xem dong "QoS ASE" / "CIS ASE" sau khi phat lai nhac.
 */
static int cmd_cispref(const struct shell *sh, size_t argc, char **argv)
{
	long rtn = strtol(argv[2], NULL, 10);
	long latency = strtol(argv[3], NULL, 10);
	uint8_t phy;

	if (parse_phy(argv[1], &phy) != 0 || phy == BT_GAP_LE_PHY_CODED || rtn < 0 || rtn > 15 ||
	    latency < 5 || latency > 4000) {
		shell_error(sh, "usage: helmet cispref <1m|2m> <rtn 0..15> <latency_ms 5..4000>");
		return -EINVAL;
	}
	le_audio_set_qos_pref(phy, (uint8_t)rtn, (uint16_t)latency);
	return 0;
}

SHELL_STATIC_SUBCMD_SET_CREATE(helmet_cmds,
	SHELL_CMD(status, NULL, "Connection, volume, streams, audio statistics", cmd_status),
	SHELL_CMD_ARG(vol, NULL, "Set volume: helmet vol <0..255>", cmd_vol, 2, 0),
	SHELL_CMD(play, NULL, "Send PLAY to phone", cmd_play),
	SHELL_CMD(pause, NULL, "Send PAUSE to phone", cmd_pause),
	SHELL_CMD(unpair, NULL, "Delete all bonds", cmd_unpair),
	SHELL_CMD_ARG(capture, NULL,
		      "Send received LC3 audio to PC over RTT channel 1: helmet capture [on|off]"
		      " (used by scripts/helmet_audio.py)",
		      cmd_capture, 1, 1),
	SHELL_CMD_ARG(aclphy, NULL, "Test: change ACL link PHY: helmet aclphy <1m|2m|coded>",
		      cmd_aclphy, 2, 0),
	SHELL_CMD_ARG(aclint, NULL, "Test: request ACL connection interval: helmet aclint <ms>",
		      cmd_aclint, 2, 0),
	SHELL_CMD_ARG(cispref, NULL,
		      "Test: preferred CIS QoS for next stream config: "
		      "helmet cispref <1m|2m> <rtn> <latency_ms>",
		      cmd_cispref, 4, 0),
	SHELL_SUBCMD_SET_END);

SHELL_CMD_REGISTER(helmet, &helmet_cmds, "Helmet LE Audio headset", NULL);

/* ---------------- main ---------------- */

int main(void)
{
	struct helmet_audio_stats st;
	int err;

	LOG_INF("=== Helmet LE Audio headset (ME54BS62 / nRF54L15) ===");

	err = audio_out_init();
	if (err) {
		return err;
	}

	/* Khong bat buoc: loi o day chi lam mat chuc nang nghe lai qua J-Link */
	(void)capture_init();

	err = bt_enable(NULL);
	if (err) {
		LOG_ERR("Bluetooth init failed (%d)", err);
		return err;
	}

	/* Nap bond + identity tu RRAM (phan vung storage) */
	if (IS_ENABLED(CONFIG_BT_SETTINGS)) {
		settings_load();
	}
	bt_conn_auth_info_cb_register(&auth_info_cb);

	err = bt_tmap_register(BT_TMAP_ROLE_UMR);
	if (err) {
		LOG_ERR("TMAP register failed (%d)", err);
		return err;
	}

	err = media_ctrl_init();
	if (err) {
		return err;
	}

	err = le_audio_init();
	if (err) {
		return err;
	}

	err = advertising_create();
	if (err) {
		return err;
	}
	k_work_submit(&adv_work);

	while (1) {
		k_sleep(K_SECONDS(HEARTBEAT_PERIOD_S));

		audio_out_get_stats(&st);
		LOG_INF("heartbeat: %s, %s, SDU %u (bad %u), PLC %u, I2S %s %u Hz q%u, "
			"sync -%u/+%u, err %u",
			active_conn ? "connected" : "advertising",
			le_audio_is_streaming() ? "STREAMING" : "idle", st.sdu_rx, st.sdu_bad,
			st.plc, st.i2s_running ? "on" : "off", st.out_rate, st.queued_blocks,
			st.drift_drop, st.drift_repeat, st.i2s_err + st.dec_err + st.q_full);
		log_link();
	}

	return 0;
}
```

## src/audio_out.c
```c
/*
 * Helmet - duong xuat am thanh: SDU LC3 -> giai ma (liblc3) -> PCM stereo -> I2S20 -> MAX98357A
 *
 * Luong du lieu:
 *   BT RX thread (stream_recv) --audio_q--> audio thread: giai ma, ghep kenh L/R, am luong
 *                                           --i2s_slab--> I2S20 (EasyDMA) -> 2 ampli
 *
 * - Moi khung LC3 (7.5/10 ms) tao ra dung 1 khoi PCM cho I2S. SDU bi mat van duoc
 *   controller bao len (co co LOST/ERROR) -> giai ma voi NULL de liblc3 noi suy (PLC),
 *   nho do I2S luon co du lieu deu dan.
 * - Clock cua dien thoai va cua Helmet lech nhau vai chuc ppm -> so khoi cho trong I2S
 *   troi dan. Khi bo dem qua day thi bo 1 khung, khi sap can thi lap lai 1 khung
 *   (khoang vai phut mot lan voi lech ~50 ppm).
 * - Moi thao tac giai ma (dung FPU) chi chay trong audio thread.
 */

#include <string.h>

#include <zephyr/kernel.h>
#include <zephyr/device.h>
#include <zephyr/devicetree.h>
#include <zephyr/drivers/i2s.h>
#include <zephyr/logging/log.h>
#include <zephyr/sys/atomic.h>
#include <zephyr/sys/util.h>

#include <lc3.h>

#include "helmet.h"

LOG_MODULE_REGISTER(audio_out, LOG_LEVEL_INF);

#define MAX_FREQ_HZ       48000
#define MAX_FRAME_US      10000
#define MAX_FRAME_SAMPLES (MAX_FREQ_HZ * MAX_FRAME_US / USEC_PER_SEC) /* 480 */
#define I2S_BLOCK_MAX     (MAX_FRAME_SAMPLES * 2 * sizeof(int16_t))    /* 1920 B */

/* So khoi PCM: driver nRF giu toi da 2 khoi + hang doi TX 4 khoi */
#define I2S_BLOCK_COUNT 8
#define PREFILL_BLOCKS  3 /* bat dau phat khi da co 3 khung (~30 ms dem jitter) */
#define HIGH_WATER      5 /* >= : bo dem qua day -> bo 1 khung */
#define LOW_WATER       1 /* <= : bo dem sap can -> lap 1 khung */

#define CH_L BIT(0)
#define CH_R BIT(1)

#define AUDIO_THREAD_STACK 4096
#define AUDIO_THREAD_PRIO  K_PRIO_PREEMPT(2)

enum audio_msg_type {
	MSG_START,
	MSG_STOP,
	MSG_DATA,
};

struct audio_msg {
	uint8_t type;
	uint8_t idx;
	uint8_t valid;
	uint16_t len;
	uint32_t ts;
	union {
		struct helmet_stream_cfg cfg;
		uint8_t data[HELMET_MAX_SDU_LEN];
	};
};

K_MSGQ_DEFINE(audio_q, sizeof(struct audio_msg), 8, 4);
K_MEM_SLAB_DEFINE_STATIC(i2s_slab, I2S_BLOCK_MAX, I2S_BLOCK_COUNT, 4);

static const struct device *const i2s_dev = DEVICE_DT_GET(DT_NODELABEL(i2s20));

/* Trang thai giai ma cua tung luong (ASE) */
struct dec_stream {
	bool active;
	struct helmet_stream_cfg cfg;
	uint8_t out_mask[2]; /* kenh LC3 thu c -> loa CH_L / CH_R / ca hai */
	lc3_decoder_t dec[2];
	lc3_decoder_mem_48k_t mem[2];
};

static struct dec_stream ds[HELMET_MAX_STREAMS];

/* Khung PCM stereo dang ghep (L, R xen ke) */
static int16_t frame_pcm[MAX_FRAME_SAMPLES * 2];
static uint8_t frame_mask;    /* kenh da co du lieu trong khung hien tai */
static uint8_t expected_mask; /* kenh cac luong dang hoat dong se cung cap */
static uint32_t frame_ts;

static uint32_t out_rate;
static uint16_t out_samples;
static bool i2s_configured;
static bool i2s_running;
static uint8_t prefill;

/* He so am luong Q15 (32767 = 0 dB) */
static atomic_t gain_q15 = ATOMIC_INIT(32767);

static struct helmet_audio_stats stats;

/* ---------------- I2S ---------------- */

static uint8_t blocks_in_use(void)
{
	return I2S_BLOCK_COUNT - k_mem_slab_num_free_get(&i2s_slab);
}

static void wait_blocks_released(void)
{
	for (int i = 0; i < 50 && blocks_in_use() > 0; i++) {
		k_msleep(2);
	}
}

/* Dung I2S ngay lap tuc va bo du lieu dang cho (dung khi dung phat / loi) */
static void i2s_halt(void)
{
	if (!i2s_configured) {
		return;
	}

	if (i2s_trigger(i2s_dev, I2S_DIR_TX, I2S_TRIGGER_DROP) != 0) {
		/* Trang thai ERROR (underrun) can PREPARE de ve READY */
		(void)i2s_trigger(i2s_dev, I2S_DIR_TX, I2S_TRIGGER_PREPARE);
	}
	wait_blocks_released();
	i2s_running = false;
	prefill = 0;
}

static int i2s_setup(uint32_t rate, uint16_t samples)
{
	struct i2s_config cfg = {
		.word_size = 16,
		.channels = 2,
		.format = I2S_FMT_DATA_FORMAT_I2S,
		.options = I2S_OPT_BIT_CLK_CONTROLLER | I2S_OPT_FRAME_CLK_CONTROLLER,
		.frame_clk_freq = rate,
		.mem_slab = &i2s_slab,
		.block_size = samples * 2 * sizeof(int16_t),
		.timeout = 20,
	};
	int err;

	i2s_halt();

	err = i2s_configure(i2s_dev, I2S_DIR_TX, &cfg);
	if (err) {
		LOG_ERR("i2s_configure %u Hz failed (%d)", rate, err);
		i2s_configured = false;
		return err;
	}

	i2s_configured = true;
	out_rate = rate;
	out_samples = samples;
	LOG_INF("I2S configured: %u Hz, %u samples/frame, BCLK P1.12 LRCLK P1.10 DIN P1.15",
		rate, samples);
	return 0;
}

static void i2s_submit(const int16_t *pcm)
{
	const size_t size = out_samples * 2 * sizeof(int16_t);
	uint8_t used = blocks_in_use();
	int copies = 1;

	if (!i2s_configured) {
		return;
	}

	if (i2s_running) {
		if (used >= HIGH_WATER) {
			stats.drift_drop++;
			return;
		}
		if (used <= LOW_WATER) {
			copies = 2;
			stats.drift_repeat++;
		}
	}

	for (int n = 0; n < copies; n++) {
		void *blk;
		int err;

		if (k_mem_slab_alloc(&i2s_slab, &blk, K_NO_WAIT) != 0) {
			stats.drift_drop++;
			return;
		}
		memcpy(blk, pcm, size);

		err = i2s_write(i2s_dev, blk, size);
		if (err) {
			k_mem_slab_free(&i2s_slab, blk);
			stats.i2s_err++;
			LOG_WRN("I2S write failed (%d) - restarting output", err);
			i2s_halt();
			return;
		}

		if (!i2s_running && ++prefill >= PREFILL_BLOCKS) {
			err = i2s_trigger(i2s_dev, I2S_DIR_TX, I2S_TRIGGER_START);
			if (err) {
				stats.i2s_err++;
				LOG_WRN("I2S start failed (%d)", err);
				i2s_halt();
				return;
			}
			i2s_running = true;
			LOG_INF("I2S output running (%u Hz)", out_rate);
		}
	}
}

/* ---------------- Ghep khung va am luong ---------------- */

static void flush_frame(void)
{
	const int32_t gain = (int32_t)atomic_get(&gain_q15);

	if (frame_mask == 0) {
		return;
	}

	/* Thieu mot ben -> chep ben con lai sang (mu co 2 loa, luon phat ca hai) */
	for (uint16_t i = 0; i < out_samples; i++) {
		int16_t *l = &frame_pcm[2 * i];
		int16_t *r = &frame_pcm[2 * i + 1];

		if (!(frame_mask & CH_L)) {
			*l = *r;
		} else if (!(frame_mask & CH_R)) {
			*r = *l;
		}
		*l = (int16_t)(((int32_t)*l * gain) >> 15);
		*r = (int16_t)(((int32_t)*r * gain) >> 15);
	}

	i2s_submit(frame_pcm);
	frame_mask = 0;
}

static void update_expected_mask(void)
{
	expected_mask = 0;
	for (size_t i = 0; i < ARRAY_SIZE(ds); i++) {
		if (ds[i].active) {
			for (uint8_t c = 0; c < ds[i].cfg.chan_cnt; c++) {
				expected_mask |= ds[i].out_mask[c];
			}
		}
	}
}

/* Kenh LC3 -> loa: theo Audio Location ma dien thoai gan cho luong */
static void map_channels(struct dec_stream *d)
{
	const uint32_t alloc = d->cfg.chan_alloc;

	if (d->cfg.chan_cnt >= 2) {
		/* Thu tu kenh trong SDU theo bit location tang dan: FL truoc FR */
		d->out_mask[0] = CH_L;
		d->out_mask[1] = CH_R;
	} else if ((alloc & BT_AUDIO_LOCATION_FRONT_LEFT) &&
		   !(alloc & BT_AUDIO_LOCATION_FRONT_RIGHT)) {
		d->out_mask[0] = CH_L;
	} else if ((alloc & BT_AUDIO_LOCATION_FRONT_RIGHT) &&
		   !(alloc & BT_AUDIO_LOCATION_FRONT_LEFT)) {
		d->out_mask[0] = CH_R;
	} else {
		/* Mono (alloc = 0) hoac vi tri khac -> phat ra ca hai loa */
		d->out_mask[0] = CH_L | CH_R;
	}
}

/* ---------------- Xu ly thong diep ---------------- */

static void handle_start(uint8_t idx, const struct helmet_stream_cfg *cfg)
{
	struct dec_stream *d = &ds[idx];
	int samples = lc3_frame_samples(cfg->frame_dur_us, cfg->freq_hz);

	if (samples <= 0 || samples > MAX_FRAME_SAMPLES || cfg->chan_cnt == 0 ||
	    cfg->chan_cnt > 2) {
		LOG_ERR("Stream %u: unsupported config (%u Hz, %u us, %u ch)", idx, cfg->freq_hz,
			cfg->frame_dur_us, cfg->chan_cnt);
		return;
	}

	d->cfg = *cfg;
	for (uint8_t c = 0; c < cfg->chan_cnt; c++) {
		d->dec[c] = lc3_setup_decoder(cfg->frame_dur_us, cfg->freq_hz, 0, &d->mem[c]);
		if (d->dec[c] == NULL) {
			LOG_ERR("Stream %u: LC3 decoder setup failed", idx);
			d->active = false;
			return;
		}
	}
	map_channels(d);
	d->active = true;
	update_expected_mask();

	if (!i2s_configured || out_rate != cfg->freq_hz || out_samples != samples) {
		frame_mask = 0;
		(void)i2s_setup(cfg->freq_hz, (uint16_t)samples);
	}

	LOG_INF("Stream %u decoding: %u Hz, %u us, %u ch, %u B/frame, alloc 0x%x -> %s", idx,
		cfg->freq_hz, cfg->frame_dur_us, cfg->chan_cnt, cfg->octets_per_frame,
		cfg->chan_alloc,
		cfg->chan_cnt >= 2                  ? "L+R"
		: d->out_mask[0] == CH_L            ? "L"
		: d->out_mask[0] == CH_R            ? "R"
						    : "L=R (mono)");
}

static void handle_stop(uint8_t idx)
{
	if (!ds[idx].active) {
		return;
	}

	ds[idx].active = false;
	update_expected_mask();
	LOG_INF("Stream %u stopped", idx);

	if (expected_mask == 0) {
		frame_mask = 0;
		i2s_halt();
		LOG_INF("I2S output stopped");
	}
}

static void handle_data(struct audio_msg *m)
{
	struct dec_stream *d = &ds[m->idx];
	const uint16_t octets = d->cfg.octets_per_frame;
	bool valid = m->valid;

	if (!d->active || !i2s_configured) {
		return;
	}

	stats.sdu_rx++;
	if (!valid) {
		stats.sdu_bad++;
	} else if (m->len < octets * d->cfg.chan_cnt) {
		stats.len_err++;
		valid = false;
	}

	/* SDU cua khoang thoi gian moi -> day khung cu ra truoc (vd luong kia bi mat) */
	if (frame_mask != 0 && m->ts != frame_ts) {
		flush_frame();
	}
	frame_ts = m->ts;

	for (uint8_t c = 0; c < d->cfg.chan_cnt; c++) {
		const uint8_t mask = d->out_mask[c];
		int16_t *dst = (mask & CH_L) ? &frame_pcm[0] : &frame_pcm[1];
		const void *in = valid ? &m->data[c * octets] : NULL; /* NULL -> PLC */
		int ret = lc3_decode(d->dec[c], in, octets, LC3_PCM_FORMAT_S16, dst, 2);

		if (ret == 1) {
			stats.plc++;
		} else if (ret < 0) {
			stats.dec_err++;
			for (uint16_t i = 0; i < out_samples; i++) {
				dst[2 * i] = 0;
			}
		}

		if (mask == (CH_L | CH_R)) {
			for (uint16_t i = 0; i < out_samples; i++) {
				frame_pcm[2 * i + 1] = frame_pcm[2 * i];
			}
		}
		frame_mask |= mask;
	}

	if ((frame_mask & expected_mask) == expected_mask) {
		flush_frame();
	}
}

static void audio_thread(void *p1, void *p2, void *p3)
{
	static struct audio_msg msg;

	ARG_UNUSED(p1);
	ARG_UNUSED(p2);
	ARG_UNUSED(p3);

	while (1) {
		k_msgq_get(&audio_q, &msg, K_FOREVER);

		switch (msg.type) {
		case MSG_START:
			handle_start(msg.idx, &msg.cfg);
			break;
		case MSG_STOP:
			handle_stop(msg.idx);
			break;
		case MSG_DATA:
			handle_data(&msg);
			break;
		default:
			break;
		}
	}
}

K_THREAD_DEFINE(audio_tid, AUDIO_THREAD_STACK, audio_thread, NULL, NULL, NULL, AUDIO_THREAD_PRIO,
		K_FP_REGS, 0);

/* ---------------- API cho cac module khac ---------------- */

int audio_out_init(void)
{
	if (!device_is_ready(i2s_dev)) {
		LOG_ERR("I2S20 not ready");
		return -ENODEV;
	}
	LOG_INF("Audio out ready: LC3 decoder (liblc3) -> I2S20 -> 2 x MAX98357A");
	return 0;
}

void audio_out_stream_start(uint8_t idx, const struct helmet_stream_cfg *cfg)
{
	struct audio_msg msg = {.type = MSG_START, .idx = idx, .cfg = *cfg};

	if (idx >= ARRAY_SIZE(ds) || k_msgq_put(&audio_q, &msg, K_MSEC(100)) != 0) {
		LOG_ERR("Stream %u: start message lost", idx);
	}
}

void audio_out_stream_stop(uint8_t idx)
{
	struct audio_msg msg = {.type = MSG_STOP, .idx = idx};

	if (idx >= ARRAY_SIZE(ds) || k_msgq_put(&audio_q, &msg, K_MSEC(100)) != 0) {
		LOG_ERR("Stream %u: stop message lost", idx);
	}
}

/* Goi tu BT RX thread: chi copy du lieu, khong giai ma o day */
void audio_out_stream_data(uint8_t idx, bool valid, uint32_t ts, const uint8_t *data,
			   uint16_t len)
{
	static struct audio_msg msg;

	if (idx >= ARRAY_SIZE(ds)) {
		return;
	}
	if (len > HELMET_MAX_SDU_LEN) {
		stats.len_err++;
		valid = false;
		len = 0;
	}

	msg.type = MSG_DATA;
	msg.idx = idx;
	msg.valid = valid;
	msg.ts = ts;
	msg.len = len;
	if (valid && len > 0) {
		memcpy(msg.data, data, len);
	}

	if (k_msgq_put(&audio_q, &msg, K_NO_WAIT) != 0) {
		stats.q_full++;
	}
}

void audio_out_set_volume(uint8_t volume, bool mute)
{
	/* Duong cong binh phuong: gan voi cam nhan tai nguoi hon tuyen tinh */
	uint32_t g = mute ? 0 : ((uint32_t)volume * volume * 32767U) / (255U * 255U);

	atomic_set(&gain_q15, (atomic_val_t)g);
}

void audio_out_get_stats(struct helmet_audio_stats *out)
{
	*out = stats;
	out->out_rate = out_rate;
	out->frame_samples = out_samples;
	out->active_mask = expected_mask;
	out->i2s_running = i2s_running;
	out->queued_blocks = blocks_in_use();
}
```

## src/helmet.h
```c
/*
 * Helmet - khai bao dung chung giua cac module.
 *
 *   le_audio.c   : BAP Unicast Server (nhan luong LC3 tu dien thoai qua CIS)
 *   media_ctrl.c : VCP Volume Renderer (am luong) + MCP client (play/pause)
 *   audio_out.c  : giai ma LC3 -> PCM -> I2S20 -> 2 x MAX98357A
 *   capture.c    : chep SDU LC3 nhan duoc ra RTT kenh 1 de nghe lai tren PC (J-Link)
 *   main.c       : Bluetooth, quang ba, ket noi, nut nhan, shell, heartbeat
 */

#ifndef HELMET_H_
#define HELMET_H_

#include <stdbool.h>
#include <stdint.h>

#include <zephyr/bluetooth/audio/audio.h>
#include <zephyr/bluetooth/conn.h>
#include <zephyr/shell/shell.h>

/* Ngu canh am thanh Helmet nhan duoc (chua co micro -> khong nhan cuoc goi) */
#define HELMET_SINK_CONTEXTS                                                                       \
	(BT_AUDIO_CONTEXT_TYPE_UNSPECIFIED | BT_AUDIO_CONTEXT_TYPE_MEDIA |                         \
	 BT_AUDIO_CONTEXT_TYPE_GAME | BT_AUDIO_CONTEXT_TYPE_INSTRUCTIONAL |                        \
	 BT_AUDIO_CONTEXT_TYPE_SOUND_EFFECTS | BT_AUDIO_CONTEXT_TYPE_NOTIFICATIONS |               \
	 BT_AUDIO_CONTEXT_TYPE_ALERTS)

/* Vi tri loa: Helmet co ca loa trai va phai */
#define HELMET_SINK_LOCATION (BT_AUDIO_LOCATION_FRONT_LEFT | BT_AUDIO_LOCATION_FRONT_RIGHT)

#define HELMET_MAX_STREAMS CONFIG_BT_ASCS_MAX_ASE_SNK_COUNT

/* SDU lon nhat: 2 kenh x 155 octet/khung x 1 khung/SDU */
#define HELMET_MAX_SDU_LEN 320

/* Cau hinh codec cua mot luong (ASE sink) da duoc dien thoai chon */
struct helmet_stream_cfg {
	uint32_t freq_hz;
	uint32_t frame_dur_us;
	uint16_t octets_per_frame;
	uint8_t chan_cnt;
	uint32_t chan_alloc; /* enum bt_audio_location, 0 = mono */
};

/* Thong ke duong am thanh (de giam sat qua shell/heartbeat) */
struct helmet_audio_stats {
	uint32_t sdu_rx;       /* SDU nhan duoc */
	uint32_t sdu_bad;      /* SDU loi/mat (da bu bang PLC) */
	uint32_t plc;          /* so khung LC3 phai noi suy (Packet Loss Concealment) */
	uint32_t dec_err;      /* loi giai ma */
	uint32_t len_err;      /* SDU sai do dai */
	uint32_t q_full;       /* SDU bi bo vi hang doi day */
	uint32_t drift_drop;   /* khoi 1 khung bi bo de bu lech clock (bo dem qua day) */
	uint32_t drift_repeat; /* khoi bi lap lai de bu lech clock (bo dem sap can) */
	uint32_t i2s_err;      /* loi/underrun I2S (da tu khoi phuc) */
	uint32_t out_rate;     /* tan so lay mau dang xuat ra I2S */
	uint16_t frame_samples;
	uint8_t active_mask;   /* BIT(0) = kenh trai, BIT(1) = kenh phai dang nhan */
	uint8_t queued_blocks; /* so khoi PCM dang cho trong I2S */
	bool i2s_running;
};

/* ---- audio_out.c ---- */
int audio_out_init(void);
void audio_out_stream_start(uint8_t idx, const struct helmet_stream_cfg *cfg);
void audio_out_stream_stop(uint8_t idx);
void audio_out_stream_data(uint8_t idx, bool valid, uint32_t ts, const uint8_t *data,
			   uint16_t len);
void audio_out_set_volume(uint8_t volume, bool mute);
void audio_out_get_stats(struct helmet_audio_stats *stats);

/* SDU nhan duoc phan loai theo co ISO cua controller */
struct helmet_rx_flags {
	uint32_t ok;    /* du lieu tot */
	uint32_t crc;   /* BT_ISO_FLAGS_ERROR: nhan duoc nhung co the hong */
	uint32_t lost;  /* BT_ISO_FLAGS_LOST: khong nhan duoc gi */
	uint32_t empty; /* hop le nhung do dai 0 */
};

/* ---- le_audio.c ---- */
int le_audio_init(void);
bool le_audio_is_streaming(void);
void le_audio_print_status(const struct shell *sh);
const char *le_audio_phy_str(uint8_t phy);
void le_audio_set_qos_pref(uint8_t phy, uint8_t rtn, uint16_t latency_ms);
void le_audio_get_rx_flags(struct helmet_rx_flags *out);
void le_audio_print_link_quality(const struct shell *sh);

/* ---- media_ctrl.c ---- */
int media_ctrl_init(void);
void media_ctrl_connected(struct bt_conn *conn);
void media_ctrl_disconnected(void);
int media_ctrl_play_pause(void);
int media_ctrl_play(void);
int media_ctrl_pause(void);
int media_ctrl_volume_up(void);
int media_ctrl_volume_down(void);
int media_ctrl_set_volume(uint8_t volume);
void media_ctrl_print_status(const struct shell *sh);

/* ---- capture.c (gui SDU LC3 nhan duoc ve PC qua RTT kenh 1) ---- */
int capture_init(void);
void capture_set_enabled(bool on);
void capture_stream_start(uint8_t idx, const struct helmet_stream_cfg *cfg);
void capture_stream_stop(uint8_t idx);
void capture_sdu(uint8_t idx, uint8_t iso_flags, uint16_t iso_seq, uint32_t ts,
		 const uint8_t *data, uint16_t len);
void capture_print_status(const struct shell *sh);

#endif /* HELMET_H_ */
```

## src/media_ctrl.c
```c
/*
 * Helmet - dieu khien am luong va media.
 *
 * - VCP Volume Renderer (Helmet la server): dien thoai doc/dat am luong cua Helmet,
 *   nut Vol+/Vol- tren mu doi am luong va dien thoai duoc thong bao lai. Am luong
 *   (0-255) + mute duoc ap dung bang he so so (digital gain) trong audio_out.
 * - MCP client (Helmet dieu khien trinh phat nhac tren dien thoai qua MCS/GMCS):
 *   nut Call gui PLAY/PAUSE.
 */

#include <errno.h>

#include <zephyr/kernel.h>
#include <zephyr/bluetooth/audio/mcc.h>
#include <zephyr/bluetooth/audio/mcs.h>
#include <zephyr/bluetooth/audio/media_proxy.h>
#include <zephyr/bluetooth/audio/vcp.h>
#include <zephyr/bluetooth/conn.h>
#include <zephyr/logging/log.h>
#include <zephyr/shell/shell.h>

#include "helmet.h"

LOG_MODULE_REGISTER(media_ctrl, LOG_LEVEL_INF);

#define VOLUME_DEFAULT 128 /* ~50 % */
#define VOLUME_STEP    16  /* 16 nac tu 0 den 255 */

static struct bt_conn *mcc_conn;
static bool mcs_ready;
static uint8_t media_state = BT_MCS_MEDIA_STATE_INACTIVE;
static uint8_t cur_volume = VOLUME_DEFAULT;
static uint8_t cur_mute = BT_VCP_STATE_UNMUTED;

static void mcs_discover_work_handler(struct k_work *work);
static K_WORK_DEFINE(mcs_discover_work, mcs_discover_work_handler);

/* ---------------- VCP Volume Renderer ---------------- */

static void vcs_state_cb(struct bt_conn *conn, int err, uint8_t volume, uint8_t mute)
{
	if (err) {
		LOG_WRN("VCS state error (%d)", err);
		return;
	}

	cur_volume = volume;
	cur_mute = mute;
	audio_out_set_volume(volume, mute == BT_VCP_STATE_MUTED);
	LOG_INF("Volume %u/255 (%u%%)%s", volume, (volume * 100U) / 255U,
		mute == BT_VCP_STATE_MUTED ? ", MUTED" : "");
}

static void vcs_flags_cb(struct bt_conn *conn, int err, uint8_t flags)
{
	if (!err) {
		LOG_DBG("VCS flags 0x%02x", flags);
	}
}

static struct bt_vcp_vol_rend_cb vcp_cbs = {
	.state = vcs_state_cb,
	.flags = vcs_flags_cb,
};

/* ---------------- MCP client ---------------- */

static void mcc_discover_mcs_cb(struct bt_conn *conn, int err)
{
	if (err) {
		LOG_WRN("Media Control Service not found (%d) - play/pause disabled", err);
		return;
	}

	mcs_ready = true;
	LOG_INF("Media Control Service found on phone");
	(void)bt_mcc_read_media_state(conn);
}

static void mcc_read_media_state_cb(struct bt_conn *conn, int err, uint8_t state)
{
	if (err) {
		return;
	}

	media_state = state;
	LOG_INF("Phone media state: %s",
		state == BT_MCS_MEDIA_STATE_PLAYING   ? "playing"
		: state == BT_MCS_MEDIA_STATE_PAUSED  ? "paused"
		: state == BT_MCS_MEDIA_STATE_SEEKING ? "seeking"
						      : "inactive");
}

static void mcc_send_cmd_cb(struct bt_conn *conn, int err, const struct mpl_cmd *cmd)
{
	if (err) {
		LOG_WRN("Media command 0x%02x failed (%d)", cmd->opcode, err);
	}
}

static struct bt_mcc_cb mcc_cb = {
	.discover_mcs = mcc_discover_mcs_cb,
	.read_media_state = mcc_read_media_state_cb,
	.send_cmd = mcc_send_cmd_cb,
};

static void mcs_discover_work_handler(struct k_work *work)
{
	int err;

	if (mcc_conn == NULL) {
		return;
	}

	err = bt_mcc_discover_mcs(mcc_conn, true);
	if (err) {
		LOG_WRN("MCS discovery start failed (%d)", err);
	}
}

static int send_media_cmd(uint8_t opcode)
{
	struct mpl_cmd cmd = {
		.opcode = opcode,
		.use_param = false,
	};

	if (mcc_conn == NULL || !mcs_ready) {
		LOG_WRN("No media control on phone");
		return -ENOTCONN;
	}

	return bt_mcc_send_cmd(mcc_conn, &cmd);
}

/* ---------------- API ---------------- */

int media_ctrl_init(void)
{
	struct bt_vcp_vol_rend_register_param vcp_param = {
		.step = VOLUME_STEP,
		.mute = BT_VCP_STATE_UNMUTED,
		.volume = VOLUME_DEFAULT,
		.cb = &vcp_cbs,
	};
	int err;

	err = bt_vcp_vol_rend_register(&vcp_param);
	if (err) {
		LOG_ERR("VCP volume renderer register failed (%d)", err);
		return err;
	}
	audio_out_set_volume(VOLUME_DEFAULT, false);

	err = bt_mcc_init(&mcc_cb);
	if (err) {
		LOG_ERR("MCC init failed (%d)", err);
		return err;
	}

	return 0;
}

/* Goi khi lien ket da ma hoa: tim MCS cua dien thoai */
void media_ctrl_connected(struct bt_conn *conn)
{
	if (mcc_conn == NULL) {
		mcc_conn = bt_conn_ref(conn);
		mcs_ready = false;
		k_work_submit(&mcs_discover_work);
	}
}

void media_ctrl_disconnected(void)
{
	if (mcc_conn != NULL) {
		bt_conn_unref(mcc_conn);
		mcc_conn = NULL;
	}
	mcs_ready = false;
	media_state = BT_MCS_MEDIA_STATE_INACTIVE;
}

int media_ctrl_play(void)
{
	return send_media_cmd(BT_MCS_OPC_PLAY);
}

int media_ctrl_pause(void)
{
	return send_media_cmd(BT_MCS_OPC_PAUSE);
}

int media_ctrl_play_pause(void)
{
	bool playing = media_state == BT_MCS_MEDIA_STATE_PLAYING ||
		       (media_state == BT_MCS_MEDIA_STATE_INACTIVE && le_audio_is_streaming());

	return playing ? media_ctrl_pause() : media_ctrl_play();
}

int media_ctrl_volume_up(void)
{
	return bt_vcp_vol_rend_unmute_vol_up();
}

int media_ctrl_volume_down(void)
{
	return bt_vcp_vol_rend_vol_down();
}

int media_ctrl_set_volume(uint8_t volume)
{
	return bt_vcp_vol_rend_set_vol(volume);
}

void media_ctrl_print_status(const struct shell *sh)
{
	shell_print(sh, "Volume    : %u/255 (%u%%)%s", cur_volume, (cur_volume * 100U) / 255U,
		    cur_mute == BT_VCP_STATE_MUTED ? " MUTED" : "");
	shell_print(sh, "Media ctl : %s, phone state %s", mcs_ready ? "ready" : "not available",
		    media_state == BT_MCS_MEDIA_STATE_PLAYING  ? "playing"
		    : media_state == BT_MCS_MEDIA_STATE_PAUSED ? "paused"
							       : "inactive");
}
```
